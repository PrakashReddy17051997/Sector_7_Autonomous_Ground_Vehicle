#include "RouteFollow.h"

// ---------------------------------------------------------------------------------------------
// THE ROUTE, taught in log_013 (2026-10-29, manual drive, 37 tagged Mark presses, same places as
// log_012). Generated by   python3 tools/make_legs.py cas_box_log/log_013.csv
// (legs + ends from the Mark tags; legs without a landmark and with the same direction merged)
// and RouteMap.h from the same log (tools/make_segments.py) - both must be re-made together.
// GPS is NOT used: the lat/lon columns are only written for reference, the leg ends come from the
// landmark + the LiDAR end scan (endRule = RULE_COMBINED). Drive at the taught speed: pad 0.30.
// ---------------------------------------------------------------------------------------------
// 17 legs from log_013.csv (tools/make_legs.py). ref = route yaw (gyro frame of the
// teaching run, deg, + = left), dSet m, effort = sum(forward wheel cmd * s), gate, end GPS = zone only
static const RouteFollow::Leg kRoute[] = {
  {RouteFollow::WALL, -1, RouteFollow::END_LOST, 0.00f,   -40.0f, 1.54f,   5.7f, 0.75f, 48.8299650, 12.9550233, 0, 0, 0, "M1-M2 L wall: wall ends left"},  // 1: t 10-40 s, GPS 3.6 m
  {RouteFollow::HOLD, -1, RouteFollow::END_FRONT, 2.48f,   -37.3f, 0.00f,   5.3f, 0.90f, 48.8299682, 12.9551345, 0, 0, 0, "M2-M4 L wall: wall starts ahead"},  // 2: t 40-113 s, GPS 8.1 m
  {RouteFollow::WALL, -1, RouteFollow::END_EFFORT, 0.00f,   -40.0f, 1.19f,   3.9f, 0.75f, 48.8299307, 12.9551900, 0, 0, 0, "M4-M5 L wall: wall starts ahead"},  // 3: t 125-140 s, GPS 5.1 m
  {RouteFollow::HOLD, -1, RouteFollow::END_EFFORT, 0.00f,  -120.2f, 0.00f,  20.8f, 0.75f, 48.8298948, 12.9552040, 1, 0, 0, "M5-M10 heading: open area left"},  // 4: t 156-418 s, GPS 3.7 m
  {RouteFollow::HOLD,  1, RouteFollow::END_EFFORT, 0.00f,  -105.8f, 0.00f,   8.7f, 0.75f, 48.8298763, 12.9551832, 0, 0, 0, "M10-M13 heading: ramp ends right"},  // 5: t 419-556 s, GPS 2.5 m
  {RouteFollow::WALL, -1, RouteFollow::END_FOUND_L, 1.00f,  -218.4f, 1.42f,   1.0f, 0.75f, 48.8297967, 12.9551000, 0, 0, 0, "M13-M17 L wall: wall starts left"},  // 6: t 598-627 s, GPS 4.5 m
  {RouteFollow::WALL, -1, RouteFollow::END_LOST, 0.00f,  -217.2f, 1.28f,   3.7f, 0.75f, 48.8297747, 12.9550727, 0, 0, 0, "M17-M18 L wall: wall ends"},  // 7: t 627-664 s, GPS 3.2 m
  {RouteFollow::WALL, -1, RouteFollow::END_EFFORT, 0.00f,  -129.2f, 1.09f,   8.0f, 0.75f, 48.8296683, 12.9548698, 0, 0, 0, "M18-M20 L wall: object beside left"},  // 8: t 683-733 s, GPS 15.9 m
  {RouteFollow::HOLD, -1, RouteFollow::END_EFFORT, 0.00f,  -126.0f, 0.00f,  12.0f, 0.75f, 48.8295938, 12.9547843, 0, 0, 0, "M20-M22 heading: open area"},  // 9: t 734-788 s, GPS 11.1 m
  {RouteFollow::HOLD, -1, RouteFollow::END_EFFORT, 0.00f,  -108.2f, 0.00f,   5.0f, 0.75f, 48.8295507, 12.9547703, 0, 0, 0, "M22-M23 heading: open area"},  // 10: t 789-810 s, GPS 4.7 m
  {RouteFollow::HOLD, -1, RouteFollow::END_EFFORT, 0.00f,  -129.8f, 0.00f,   5.4f, 0.75f, 48.8294375, 12.9546872, 0, 0, 0, "M23-M28 heading: ramp ends ahead"},  // 11: t 832-874 s, GPS 9.1 m
  {RouteFollow::HOLD,  1, RouteFollow::END_EFFORT, 0.00f,  -149.7f, 0.00f,  10.4f, 0.75f, 48.8294173, 12.9546633, 0, 0, 0, "M28-M30 heading: open area right"},  // 12: t 874-932 s, GPS 2.8 m
  {RouteFollow::HOLD,  1, RouteFollow::END_EFFORT, 0.00f,  -175.6f, 0.00f,   3.5f, 0.75f, 48.8294085, 12.9546225, 0, 0, 0, "M30-M31 heading: corner right"},  // 13: t 932-952 s, GPS 3.1 m
  {RouteFollow::WALL, -1, RouteFollow::END_FOUND_L, 2.33f,  -221.5f, 2.43f,   1.0f, 0.75f, 48.8293993, 12.9545557, 0, 0, 0, "M31-M33 L wall: wall starts left"},  // 14: t 965-968 s, GPS 0.6 m
  {RouteFollow::HOLD, -1, RouteFollow::END_LOST, 0.00f,  -217.8f, 0.00f,   9.9f, 0.75f, 48.8293833, 12.9543630, 0, 0, 0, "M33-M34 heading: wall ends ahead"},  // 15: t 978-1028 s, GPS 12.0 m
  {RouteFollow::HOLD, -1, RouteFollow::END_EFFORT, 0.00f,  -236.3f, 0.00f,   2.8f, 0.75f, 48.8293975, 12.9543165, 0, 0, 0, "M34-M35 L wall: corner right"},  // 16: t 1028-1052 s, GPS 3.8 m
  {RouteFollow::WALL, -1, RouteFollow::END_EFFORT, 0.00f,  -313.1f, 1.68f,   4.4f, 0.75f, 48.8294377, 12.9543120, 0, 0, 0, "M35-M36 L wall: corner right"},  // 17: t 1060-1080 s, GPS 4.3 m
};

static const uint8_t kN = sizeof(kRoute) / sizeof(kRoute[0]);
// true bearing (clockwise from north) = kBearingOfRouteYaw0 - routeYaw. From the facade:
// GPS course along B = 125 deg at route yaw kRoute[0].ref (-37.8).
static const float kBearingOfRouteYaw0 = 125.0f + (-37.8f);
static const float kEffortEnd = 0.97f;   // EFFORT legs end here (teaching run zig-zagged a bit)
static const float kMPerDeg = 111194.93f;

uint8_t RouteFollow::count() { return kN; }
const RouteFollow::Leg& RouteFollow::leg(uint8_t i) { return kRoute[i < kN ? i : kN - 1]; }

static bool gpsGood(const Sensors& s) { return s.gpsFix() && s.hdop() > 0 && s.hdop() <= 2.5f; }
static void enu(double lat0, double lon0, double lat1, double lon1, float& e, float& n) {
  n = (float)((lat1 - lat0) * kMPerDeg);
  e = (float)((lon1 - lon0) * kMPerDeg * cos(lat0 * DEG_TO_RAD));
}

// ---------------------------------------------------------------------------------------------

bool RouteFollow::start(const Sensors& s, const WallFollow& wf, uint8_t i, float speed, bool singleLeg) {
  if (i >= kN) i = 0;
  const Leg& L = leg(i);
  // heading anchor: the rover stands parallel to the leg (to its wall on WALL legs)
  if (!s.imuOk()) { strlcpy(_msg, "no IMU", sizeof(_msg)); return false; }
  if (L.kind == WALL) {
    const WallFollow::Wall w = wf.measure(s, L.side < 0 ? WallFollow::LEFT : WallFollow::RIGHT, nullptr);
    if (!w.ok) {
      snprintf(_msg, sizeof(_msg), "leg %u: no wall seen on the %s", (unsigned)(i + 1), L.side < 0 ? "left" : "right");
      return false;
    }
    if (fabsf(w.angleDeg) > startTolDeg) {   // log_0014: started at -54 deg to the wall -> wrong reference
      snprintf(_msg, sizeof(_msg), "leg %u: turn rover parallel to wall (%.0f deg)", (unsigned)(i + 1), w.angleDeg);
      return false;
    }
    const float wallYawGyro = L.side < 0 ? s.yawDeg() + w.angleDeg : s.yawDeg() - w.angleDeg;
    _off = _wrap(L.ref - wallYawGyro);
  } else {
    _off = _wrap(L.ref - s.yawDeg());  // rover points along the leg
  }
  _i = i;
  _loc.enabled = RouteLocalizer::mapLegs() == kN;  // map from another teaching run: do not use it
  if (!_loc.enabled)
    Serial.printf("[route] RouteMap.h has %u legs, kRoute %u - LiDAR end match OFF (old rule). "
                  "Re-run tools/make_segments.py + make_legs.py\n", (unsigned)RouteLocalizer::mapLegs(), (unsigned)kN);
  _loc.beginLeg(i);
  _lpOn = pathMode && _lp.legs() == kN;   // LocalPath.h from the same teaching run as kRoute
  if (_lpOn) _lp.begin(i);                // rover at the start of leg i, pointing along it
  _lpYawPrev = s.yawDeg();
  _lpEffAcc = 0;
  _pitch0 = s.pitchDeg();
  _lpOkMs = 0;
  _speed = speed;
  _hasRun = true;
  _eff = 0; _I = 0; _seen = _lostN = _foundN = _frN = 0; _lowN = 0; _pivoting = false; _yawDesInit = false;
  _avTries = 0; _stuckN = 0; _backups = 0; _refMs = 0; _overrun = false; _passEff = -99; _forced = 0;
  _wN = 0; _drift = 0; _pivotEndMs = 0; _tapPh = 0; _tapGain = tapGain0;
  _stopAfter = singleLeg ? i : 255;
  _endInfo[0] = 0;
  _state = DRIVE;
  _stateMs = _lastStep = millis();
  snprintf(_msg, sizeof(_msg), "leg %u: %s", (unsigned)(i + 1), L.name);
  return true;
}

bool RouteFollow::resume(float speed) {
  if (!canResume()) return false;
  _speed = speed;
  if (_overrun) {  // paused because the landmark was not found: accept it from now on
    _eff = fminf(_eff, _cur().gate * _cur().effort);
    _overrun = false;
  }
  _state = _resumeState == TURN ? TURN : DRIVE;
  _stuckN = 0; _refMs = 0; _I = 0; _lowN = 0; _pivoting = false; _yawDesInit = false; _tapPh = 0;
  _stateMs = millis();
  snprintf(_msg, sizeof(_msg), "resumed leg %u: %s", (unsigned)(_i + 1), _cur().name);
  return true;
}

void RouteFollow::pause(const char* why) {
  if (_state == OFF || _state == DONE) return;
  if (_state != PAUSED) _resumeState = _state;
  _state = PAUSED;
  _l = _r = 0;
  if (why != _msg) strlcpy(_msg, why, sizeof(_msg));
  Serial.printf("[route] pause: %s\n", why);
}

void RouteFollow::feedOutput(float l, float r) {
  const uint32_t now = millis();
  const float dt = (now - _lastOut) / 1000.0f;
  _lastOut = now;
  if (!active() || dt > 0.5f) return;
  const float v = 0.5f * (l + r);
  if (v > 0) { _eff += v * dt; _lpEffAcc += v * dt; }
}

// path heading error (rad, + = left): straight line to the next corner of the taught path at least
// pathLookM ahead (lineLook), or the pure-pursuit point pathLookM ahead
float RouteFollow::_pathErrRad() const {
  return lineLook ? _lp.headingErrorToWaypoint(pathLookM) : _lp.headingErrorTo(pathLookM);
}

bool RouteFollow::pathLocked() const {
  return _lpOn && _lp.lostN() < 8 && _lpOkMs != 0 && millis() - _lpOkMs < 3000;
}

void RouteFollow::steer(const Sensors& s, const WallFollow& wf, float& l, float& r) {
  const uint32_t now = millis();
  if (now - _lastStep >= 250) {  // one step per sensor snapshot (4 Hz): targets, legs, obstacles
    _lastStep = now;
    _ctrlOn = false;             // a step that does not call _drive sets _l / _r itself (wait, back up)
    _step(s, wf);
  }
  if (_ctrlOn && active()) _control(s);   // heading controller on the live gyro yaw, every pass
  else {
    if (_tapPh) { _tapPh = 0; _pivoting = false; _pivotEndMs = now; }   // the step drives itself: tap off
    _why = WHY_STEP;
  }
  l = _l;
  r = _r;
}

// ---------------------------------------------------------------------------------------------

bool RouteFollow::_wallNow(const Sensors& s, const WallFollow& wf, int8_t side, float& d, float& dirYaw,
                           float& rms, uint8_t& pts) const {
  const WallFollow::Wall w = wf.measure(s, side < 0 ? WallFollow::LEFT : WallFollow::RIGHT, nullptr);
  if (!w.ok || w.points < 6) return false;
  const float ry = routeYaw(s);
  dirYaw = _wrap(side < 0 ? ry + w.angleDeg : ry - w.angleDeg);  // direction of the wall line
  d = w.distM; rms = w.rmsM; pts = w.points;
  return true;
}

// Free length (m) of a corridor 2*half wide in direction phi (+ = right of the nose), up to look.
// Uses the SECOND closest point: one stray LiDAR point does not block the way (log_011: 30 false
// obstacle stops on legs 1-2 from single points 25-66 cm away). Returns < 25 cm are ignored
// (SafetyGuard handles really close things).
float RouteFollow::_corridor(const Sensors& s, float phiDeg, float half, float look) const {
  float b1 = look, b2 = look;
  for (uint8_t i = 0; i < Sensors::kLidarPoints; i++) {
    const uint16_t cm = s.lidarCm(i);
    if (cm < 25) continue;
    const float a = (i * 4.0f + 2.0f - phiDeg) * DEG_TO_RAD, rr = cm / 100.0f;
    const float along = rr * cosf(a), lat = rr * sinf(a);
    if (along <= 0 || fabsf(lat) >= half) continue;
    if (along < b1) { b2 = b1; b1 = along; } else if (along < b2) b2 = along;
  }
  return b2;
}

float RouteFollow::_front(const Sensors& s) const { return _corridor(s, 0, 0.35f, 1.5f); }

// Median change (cm) of the LiDAR points between now and the reference scan of 2 s ago.
float RouteFollow::_scanChangeCm(const Sensors& s) const {
  uint8_t hist[64] = {0};
  uint8_t n = 0;
  for (uint8_t i = 0; i < Sensors::kLidarPoints; i++) {
    const uint16_t a = s.lidarCm(i), b = _ref[i];
    if (a < 25 || b < 25 || a > 500 || b > 500) continue;
    int d = abs((int)a - (int)b);
    if (d > 63) d = 63;
    hist[d]++;
    n++;
  }
  if (n < 15) return 99;  // too few points to tell: count as moving
  uint8_t c = 0;
  for (uint8_t k = 0; k < 64; k++) { c += hist[k]; if (c > n / 2) return k; }
  return 63;
}

// Sets the target for _control: e = wanted - current heading (deg, + = left), v = forward command,
// fwd = roll forwards (else backwards, e.g. obstacle ahead). Called from the 4 Hz _step.
void RouteFollow::_drive(float e, float v, bool fwd) {
  _tgtYaw = _wrap(_stepRy + e);              // absolute target, from the snapshot heading of this step
  _tgtV = v;
  _tgtFwd = fwd;
  _ctrlOn = true;
}

// Heading controller, every loop pass (max 50 Hz), on the LIVE gyro yaw (Sensors::yawNowDeg, 50 Hz).
// Field test log_014 / log_0014 (2026-10-29): a wheel difference does NOT turn this rover (0.31 / 0.40
// for 3 s: it still turned right at the same 3-4 deg/s as with equal wheels). So corrections are
// PIVOTS only (arcMax = 0), closed on the gyro:
//   eC = e + bias            bias = the rover's own drift (learned while rolling) * driftLeadS:
//                            after a correction it points a little left, the drift brings it back
//   |eC| <= corrDeg (8)      roll straight
//   |eC| >  corrDeg          ONE tap (after >= minRollMs of rolling; at once if |eC| > pivotDeg):
//                            length = tapAim * |eC| / tapGain (40-300 ms), then settle >= settleMs
//                            until the gyro is quiet, then tapGain is corrected from what it turned
// arcMax > 0 switches the gentle-arc correction of the first version back on (not for this rover).
void RouteFollow::_control(const Sensors& s) {
  const uint32_t now = millis();
  if (_ctrlMs != 0 && now - _ctrlMs < 20) return;          // 50 Hz; _l / _r stay
  const float dt = _ctrlMs == 0 ? 0 : (now - _ctrlMs) / 1000.0f;
  _ctrlMs = now;
  const float y = _wrap(s.yawNowDeg() + _off);              // live route yaw
  if (dt > 0 && dt < 0.5f) _rate = 0.7f * _rate + 0.3f * _wrap(y - _prevYaw) / dt;
  else _rate = 0;
  _prevYaw = y;
  const float base = _tgtFwd ? _tgtV : -rollBackCmd;
  // the rover's own drift while rolling straight (deg/s, + = left); log_012/013: about -3
  if (!_pivoting && now >= _unstallUntil && _tgtFwd && dt > 0 && dt < 0.5f && now - _pivotEndMs > 500)
    _drift += 0.02f * (_rate - _drift);
  const float bias = _clamp(-_drift * driftLeadS, -4.0f, 4.0f);
  const float e = _wrap(_tgtYaw - y);
  const float eC = e + bias;
  _ctrlErr = eC;
  const float ae = fabsf(eC);
  const int8_t dir = eC > 0 ? 1 : -1;                       // + = turn left

  // ---- TAP AND SETTLE (field test log_015/016, 2026-10-29): the rover answers a pivot command only
  // 0.25-0.5 s later and then still turns ~30 deg per short tap. A pivot closed on the gyro therefore
  // ran on far too long (it saw nothing yet) -> 25-35 deg overshoot -> pivot back -> zig-zag.
  // Now: one open-loop tap whose LENGTH is computed from the error (rotation = tapGain * time, learned),
  // then hands off (roll straight / stand) until the turn is over (settleMs and the gyro rate is low),
  // then measure what the tap really did and correct tapGain. Only then the next decision.
  if (_tapPh == 1) {                                         // tap running
    if (now < _tapUntil) { _l = _tapDir > 0 ? -pivotCmd : pivotCmd; _r = -_l; _why = WHY_TAP; return; }
    _tapPh = 2; _tapEndMs = now;
  }
  if (_tapPh == 2) {                                         // settle: the rover is still turning
    _l = _r = _tgtFwd ? base : 0.0f;
    _why = WHY_SETTLE;
    const uint32_t since = now - _tapEndMs;
    if (since < settleMs || (fabsf(_rate) > 12.0f && since < 1500)) return;
    // learn: degrees turned per second of tap (battery, floor, wheels, rover firmware ramp)
    const float done = _tapDir * _wrap(y - _tapYaw0);
    if (_tapReq >= 6.0f && done > 0.5f) {
      const float ratio = _clamp(done / _tapReq, 0.5f, 2.0f);
      _tapGain = _clamp(_tapGain * sqrtf(ratio), 40.0f, 400.0f);
    } else if (_tapReq >= 6.0f && done <= 0.5f) {
      _tapGain = _clamp(_tapGain * 0.7f, 40.0f, 400.0f);       // did not move: tap longer next time
    }
    _tapPh = 0; _pivoting = false; _pivotEndMs = now;
  }
  const bool rolledEnough = now - _pivotEndMs >= minRollMs;
  if (ae >= pivotDeg || (ae > corrDeg && rolledEnough) || (arcMax <= 0 && ae > corrDeg && !_tgtFwd)) {
    // aim a little short (tapAim): an undershoot is finished by the next tap, an overshoot starts a zig-zag
    _tapReq = tapAim * ae;
    uint32_t ms = (uint32_t)(1000.0f * _tapReq / _tapGain);
    if (ms < tapMinMs) ms = tapMinMs;
    if (ms > tapMaxMs) ms = tapMaxMs;                        // big turns: several taps
    _tapReq = _tapGain * ms / 1000.0f;                       // what this tap should give
    _tapDir = dir; _tapYaw0 = y; _tapUntil = now + ms; _tapPh = 1; _pivoting = true; _pivotMs = now;
    _l = _tapDir > 0 ? -pivotCmd : pivotCmd; _r = -_l;
    _why = WHY_TAP;
    return;
  }
  if (arcMax <= 0) { _l = _r = base; _why = _tgtFwd ? WHY_ROLL : WHY_STAND; return; }                    // straight: corrections are pivots
  // optional gentle arcs (arcMax > 0)
  if (_tgtFwd && dt > 0 && dt < 0.5f) _I = _clamp(_I + kI * e * dt, -0.75f * arcMax, 0.75f * arcMax);
  const float p = fabsf(e) > deadbandDeg ? kP * (e - (e > 0 ? deadbandDeg : -deadbandDeg)) : 0.0f;
  const float diff = _tgtFwd ? _clamp(p + _I, -arcMax, arcMax) : 0.0f;   // + = turn left
  _l = base - diff;
  _r = base + diff;
}

// Keeps the last 5 wall readings of this leg; a reading more than wallJumpDeg off their median is
// dropped (one scan that fits a corner, a gap or a bench). d / wy become the medians.
bool RouteFollow::_wallFilter(float& d, float& wy) {
  if (_wN >= 3) {
    float a[5];
    for (uint8_t k = 0; k < _wN; k++) a[k] = _wrap(_wyBuf[k] - wy);
    for (uint8_t x = 1; x < _wN; x++) for (uint8_t q = x; q > 0 && a[q - 1] > a[q]; q--) { const float t = a[q]; a[q] = a[q - 1]; a[q - 1] = t; }
    if (fabsf(a[_wN / 2]) > wallJumpDeg) { _wRej++; if (_wRej < 4) return false; _wN = 0; }  // 4 in a row: the wall really turned
  }
  _wRej = 0;
  _wyBuf[_wI] = wy; _dBuf[_wI] = d; _wI = (_wI + 1) % 5; if (_wN < 5) _wN++;
  float a[5], b[5];
  for (uint8_t k = 0; k < _wN; k++) { a[k] = _wrap(_wyBuf[k] - wy); b[k] = _dBuf[k]; }
  for (uint8_t x = 1; x < _wN; x++) for (uint8_t q = x; q > 0 && a[q - 1] > a[q]; q--) { const float t = a[q]; a[q] = a[q - 1]; a[q - 1] = t; }
  for (uint8_t x = 1; x < _wN; x++) for (uint8_t q = x; q > 0 && b[q - 1] > b[q]; q--) { const float t = b[q]; b[q] = b[q - 1]; b[q - 1] = t; }
  wy = _wrap(wy + a[_wN / 2]);
  d = b[_wN / 2];
  return true;
}

void RouteFollow::_nextLeg(const Sensors& s, const char* how) {
  const Leg& L = _cur();
  char warn[24] = "";
  if (!L.gpsBlind && gpsGood(s)) {  // GPS = approximate zone only
    float e, n;
    enu(L.lat, L.lon, s.lat(), s.lon(), e, n);
    const float dz = sqrtf(e * e + n * n);
    if (dz > zoneWarnM) snprintf(warn, sizeof(warn), " (GPS %.0f m off)", dz);
  }
  char sc[40] = "no end scan yet";   // end-scan match: now / base level of the leg (cm, lower = closer)
  if (_loc.costNow() >= 0)
    snprintf(sc, sizeof(sc), "scan %.0f/%.0f cm%s", _loc.costNow(), _loc.base(), _loc.dip() ? " dip" : "");
  Serial.printf("[route] leg %u done (%s), effort %.1f/%.1f, %s%s, tap %.0f deg/s, drift %.1f deg/s\n", (unsigned)(_i + 1), how, _eff, L.effort, sc, warn, _tapGain, _drift);
  if (_lpOn && _lp.leg() == _i && _i + 1 < kN) _lp.nextLeg();   // keep the local frame on the same leg
  snprintf(_endInfo, sizeof(_endInfo), "leg %u: %s, effort %.0f %%, %s%s", (unsigned)(_i + 1), how,
           L.effort > 0 ? 100.0f * _eff / L.effort : 0.0f, sc, warn);
  if (_i == _stopAfter) {             // segment test: this leg only
    _state = DONE;
    _l = _r = 0;
    snprintf(_msg, sizeof(_msg), "leg %u test done (%s)", (unsigned)(_i + 1), how);
    return;
  }
  if (_i + 1 >= kN) {
    _state = DONE;
    _l = _r = 0;
    snprintf(_msg, sizeof(_msg), "route done (%s)%s", how, warn);
    return;
  }
  _i++;
  _loc.beginLeg(_i);
  _eff = 0; _I = 0; _seen = _lostN = _foundN = _frN = 0; _lowN = 0; _pivoting = false; _yawDesInit = false;
  _avTries = 0; _backups = 0; _stuckN = 0; _passEff = -99; _wN = 0;
  _state = TURN;
  _stateMs = millis();
  snprintf(_msg, sizeof(_msg), "leg %u: %s%s", (unsigned)(_i + 1), _cur().name, warn);
}

void RouteFollow::_step(const Sensors& s, const WallFollow& wf) {
  if (!active()) { _l = _r = 0; return; }
  const Leg& L = _cur();
  const uint32_t now = millis();
  const float ry = routeYaw(s);
  _stepRy = ry;
  // ---- local path localisation: every step, in every state (turns and obstacles included)
  if (_lpOn) {
    for (uint8_t k = 0; k < Sensors::kLidarPoints; k++) _scan[k] = s.lidarCm(k);
    const float dy = _wrap(s.yawDeg() - _lpYawPrev) * DEG_TO_RAD;
    _lpYawPrev = s.yawDeg();
    _lp.step(_scan, dy, _lpEffAcc, fabsf(s.pitchDeg() - _pitch0) >= 5.0f);
    _lpEffAcc = 0;
    if (_lp.ok()) _lpOkMs = now;
    if (_lp.atEnd() && (_state == DRIVE || _state == TURN)) { _nextLeg(s, "path end"); return; }
  }

  // ---- ground / progress: median change of the LiDAR points against the last snapshot (0.25 s).
  // Rolling straight but the scene does not move (< 1 cm) for 3 steps: rough ground, grass, a ramp
  // foot -> boost the forward command a little more every step (MotorShaper adds it); moving again
  // (>= 2 cm) -> boost back down. Never downhill (front down > 4 deg: gravity does it).
  {
    float d[Sensors::kLidarPoints];
    uint8_t m = 0;
    for (uint8_t k = 0; k < Sensors::kLidarPoints; k++) {
      const uint16_t a = s.lidarCm(k), c = _prevScan[k];
      if (a > 25 && c > 25 && a < 500 && c < 500) d[m++] = fabsf((float)a - (float)c);
      _prevScan[k] = a;
    }
    float med = 99;
    if (m >= 15) {
      for (uint8_t x = 1; x < m; x++) for (uint8_t q = x; q > 0 && d[q - 1] > d[q]; q--) { const float t = d[q]; d[q] = d[q - 1]; d[q - 1] = t; }
      med = d[m / 2];
    }
    _progCm = med;
    const bool rolling = _state == DRIVE && _why == WHY_ROLL && _l > 0.05f && _r > 0.05f;
    if (rolling && med < 1.0f && s.pitchDeg() < 4.0f) { if (_noProgN < 255) _noProgN++; } else _noProgN = 0;
    if (_noProgN >= 3) _boost = fminf(boostMax, _boost + boostStep);
    else if (!rolling || med >= 2.0f) _boost = fmaxf(0.0f, _boost - 2.0f * boostStep);
  }

  // ---- stuck detection: commanded to move for the whole 2 s, but the scene did not change
  const bool moving = fabsf(_l) + fabsf(_r) > 0.2f;
  if (_refMs == 0 || now - _refMs >= 2000) {
    if (_refMs && _refMoving && moving && _state != BACKUP) {
      const float ch = _scanChangeCm(s);
      const float dy = fabsf(_wrap(s.yawDeg() - _refYaw));
      _stuckN = (ch < 2.5f && dy < 3.0f) ? _stuckN + 1 : 0;
    } else {
      _stuckN = 0;
    }
    for (uint8_t i = 0; i < Sensors::kLidarPoints; i++) _ref[i] = s.lidarCm(i);
    _refYaw = s.yawDeg();
    _refMs = now;
    _refMoving = moving;
  } else {
    _refMoving = _refMoving && moving;
  }
  if (_stuckN >= 2) {
    _stuckN = 0;
    if (++_backups >= maxBackups) { pause("stuck - help me, then Resume"); return; }
    _state = BACKUP;
    _stateMs = now;
    strlcpy(_msg, "stuck - backing up", sizeof(_msg));
    Serial.println("[route] stuck -> back up");
  }

  switch (_state) {
    case BACKUP:
      _l = _r = -0.3f;
      if (now - _stateMs >= 1500) { _state = DRIVE; _l = _r = 0; }
      return;

    case TURN: {
      // path mode: turn towards the taught path 1 m ahead, else to the leg direction
      const float e = pathLocked() ? _pathErrRad() * RAD_TO_DEG : _wrap(L.ref - ry);
      if (fabsf(e) < turnDoneDeg && !_pivoting) { _state = DRIVE; return; }
      _drive(e, _speed, _front(s) > 0.6f);  // _control pivots on the gyro until the heading is reached
      return;
    }

    case AVOID: {
      const float fr = _front(s);
      if (_avPhase == 0) {                     // wait: people / bikes pass by
        _l = _r = 0;
        for (uint8_t i = 0; i < Sensors::kLidarPoints; i++) _scan[i] = s.lidarCm(i);
        // path mode: free again = nothing NEW (not in the leg map) in the corridor ahead; mapped walls
        // close to the taught path are fine (you drove past them in the teaching run)
        const bool lpFree = pathLocked() && _corridor(s, 0, 0.18f, 1.5f) > lpStopM + 0.05f && _lp.newPointsAhead(_scan, 0.35f, avoidEnterM) < 2;
        const bool lpTurn = pathLocked() && fabsf(_pathErrRad()) * RAD_TO_DEG > 2.0f * turnDoneDeg + 12.0f;
        if (lpTurn) { _state = TURN; return; }
        if (lpFree || fr > avoidFreeM - 0.2f) { _state = DRIVE; strlcpy(_msg, "way free again", sizeof(_msg)); return; }
        if (now - _stateMs < 3000) return;
        // closest free direction, never right where the open edge is
        float best = 999;
        for (int a = 20; a <= 60 && best > 900; a += 10) {
          for (int sg = -1; sg <= 1; sg += 2) {
            const float phi = sg * a;          // + = right
            if (phi > 0 && L.noRight) continue;
            if (_corridor(s, phi, 0.35f, 1.5f) >= avoidFreeM) { best = phi; break; }
          }
        }
        if (best > 900) {
          if (++_avTries >= 3) { pause("blocked - help me, then Resume"); return; }
          _stateMs = now;                      // wait another 3 s
          strlcpy(_msg, "blocked - waiting", sizeof(_msg));
          return;
        }
        _avTarget = _wrap(ry - best);          // yaw + = left
        _avPhase = 1;
        strlcpy(_msg, best < 0 ? "obstacle - passing left" : "obstacle - passing right", sizeof(_msg));
        return;
      }
      if (_avPhase == 1) {                     // turn to the free direction (roll BACK between taps)
        const float e = _wrap(_avTarget - ry);
        if (fabsf(e) < turnDoneDeg && !_pivoting) { _avPhase = 2; _avEff = _eff; _l = _r = 0; return; }
        _drive(e, _speed, false);
        return;
      }
      if (_avPhase == 2) {                     // sidestep until the leg direction is free
        if (fr < avoidEnterM || _eff - _avEff > 3.0f) { _avPhase = 0; _stateMs = now; _l = _r = 0; return; }
        const float back = _corridor(s, -_wrap(L.ref - ry), 0.35f, 1.5f);  // along the leg (+ = right)
        if (_eff - _avEff > 0.4f && (back >= 1.45f || pathLocked())) { _avPhase = 3; _l = _r = 0; return; }
        _drive(_wrap(_avTarget - ry), _speed, true);
        return;
      }
      {                                        // phase 3: turn back parallel to the leg / towards the path
        const float e = pathLocked() ? _pathErrRad() * RAD_TO_DEG : _wrap(L.ref - ry);
        if (fabsf(e) < turnDoneDeg && !_pivoting) {
          _state = DRIVE; _passEff = _eff; _l = _r = 0;
          strlcpy(_msg, "obstacle passed", sizeof(_msg));
          return;
        }
        _drive(e, _speed, fr > 0.6f);
        return;
      }
    }

    case DRIVE: {
      // ---- obstacle ahead
      for (uint8_t i = 0; i < Sensors::kLidarPoints; i++) _scan[i] = s.lidarCm(i);
      const float fr = _front(s);
      // path mode: pointing well away from the taught path (leg hand-over at a corner, after passing
      // an obstacle) -> pivot on the spot first; the wall it is facing is not in the way of the path
      if (pathLocked() && fabsf(_pathErrRad()) * RAD_TO_DEG > 2.0f * turnDoneDeg + 12.0f) {
        _state = TURN; _l = _r = 0; return;
      }
      // closer than hardStopM: ALWAYS handle it (log_014: the static filter let it drive into a wall the
      // teaching run had also seen - in the teaching run you turned before it). A leg that ends at a wall
      // ahead (END_FRONT) ends here.
      const bool ramp = (rampLegs >> _i) & 1u;   // ramp leg: the ramp surface is not an obstacle
      // path mode, locked: walls of the taught map only count closer than 0.25 m (you drove the
      // teaching run within 5-25 cm of things in places); NEW things (not in the map) at hardStopM
      // (narrow corridor 0.18 m = rover half width + 5 cm: the teaching run passed walls that close)
      const bool lpk = pathLocked() && _lp.newPointsAhead(_scan, 0.35f, hardStopM) < 2;
      // log_020 leg 9 end: drove into a mapped structure to 20 cm (the old 0.20 here) - the teaching run
      // had turned before it. Mapped walls in the rover-wide corridor now stop at lpStopM.
      const float hs = lpk ? lpStopM : hardStopM;
      const float frStop = lpk ? _corridor(s, 0, 0.18f, 1.5f) : fr;
      if (!ramp && frStop < hs) {
        if (L.end == END_FRONT && _eff >= 0.3f * L.effort) { _nextLeg(s, "wall ahead reached"); return; }
        _lowN = 1;   // with this pass: 2 -> obstacle handling now
      }
      bool blocked = lpk ? frStop < hs : fr < avoidEnterM;
      // something ahead that the teaching run also saw there (wall at a turn, railing, ramp edge)
      // is static: drive on - but only if it is still farther than hardStopM. Only >= 2 NEW points
      // start the obstacle handling.
      if (blocked && !lpk && fr >= hs && staticFilter) {
        if (pathLocked()) blocked = _lp.newPointsAhead(_scan, 0.35f, avoidEnterM) >= 2;   // vs the leg map (cm-exact)
        else if (_loc.hasMap()) blocked = _loc.newPointsAhead(_scan, 0.35f, avoidEnterM) >= 2;
      }
      if (ramp) blocked = false;
      _lowN = blocked ? (uint8_t)(_lowN + 1) : 0;
      if (_lowN >= 2) {                        // two scans in a row: a real obstacle
        _state = AVOID; _avPhase = 0; _stateMs = now; _l = _r = 0; _lowN = 0;
        strlcpy(_msg, "obstacle - waiting", sizeof(_msg));
        return;
      }
      const float v = _speed;                  // no slowing down: wheel differences stall it

      // ---- where to point
      float d = 0, wy = 0, rms = 1;
      uint8_t pts = 0;
      bool valid = _wallNow(s, wf, L.side, d, wy, rms, pts) && fabsf(_wrap(wy - L.ref)) < wallTolDeg;
      if (valid) valid = _wallFilter(d, wy);   // median of the last 5, single outliers (log_014: -2 -> -29 deg) dropped
      float yawDes = L.ref;
      const bool passing = _eff - _passEff < 2.5f;  // just passed an obstacle: parallel, no approach
      if (L.kind == WALL && valid && passing) {
        yawDes = wy;
      } else if (L.kind == WALL && valid) {
        // pure pursuit on the wall line: aim at the set distance lookAheadM ahead (+ = towards the wall)
        const float app = _clamp(atan2f(d - L.dSet, lookAheadM) * RAD_TO_DEG, -maxApproachDeg, maxApproachDeg);
        yawDes = wy + (L.side < 0 ? app : -app);
        if (rms < 0.04f && pts >= 8) _off = _wrap(_off + _clamp(anchorGain * _wrap(L.ref - wy), -0.5f, 0.5f));
      } else if (L.kind == HOLD && L.gpsAssist && !L.gpsBlind && gpsGood(s)) {
        float e, n;
        enu(s.lat(), s.lon(), L.lat, L.lon, e, n);
        if (e * e + n * n > 36.0f) {           // > 6 m from the end zone: head a bit towards it
          const float want = _wrap(kBearingOfRouteYaw0 - atan2f(e, n) * RAD_TO_DEG);
          yawDes = _wrap(L.ref + _clamp(_wrap(want - L.ref), -15.0f, 15.0f));
        }
      }
      // smooth the target: the wall angle from one 90-point scan jitters by a few degrees
      if (!_yawDesInit) { _yawDesF = yawDes; _yawDesInit = true; }
      _yawDesF = _wrap(_yawDesF + 0.5f * _wrap(yawDes - _yawDesF));
      if (pathLocked()) _drive(_pathErrRad() * RAD_TO_DEG, v, true);   // pure pursuit on the taught path
      else _drive(_wrap(_yawDesF - ry), v, true);                                         // fallback: wall / heading
      if (_avTries && _eff - _avEff > 3.0f) _avTries = 0;

      // ---- end of the leg?
      const bool gate = _eff >= L.gate * L.effort;
      bool end = false;
      switch (L.end) {
        case END_LOST:
          if (valid) { _seen = 1; _lostN = 0; } else if (_lostN < 255) _lostN++;
          end = gate && _seen && _lostN >= 6;
          break;
        case END_FOUND_L:
        case END_FOUND_R: {
          float fd, fwy, frms; uint8_t fp;
          const bool ok = _wallNow(s, wf, L.end == END_FOUND_L ? -1 : 1, fd, fwy, frms, fp) && fd < L.endArg;
          _foundN = ok ? (_foundN < 255 ? _foundN + 1 : 255) : 0;
          end = gate && _foundN >= 4;
          break;
        }
        case END_FRONT: {
          _fr[_frI++ & 3] = _corridor(s, 0, 0.35f, 3.0f);
          if (_frN < 4) _frN++;
          if (_frN >= 4) {  // median of the last 4 scans
            float a[4] = {_fr[0], _fr[1], _fr[2], _fr[3]};
            for (uint8_t x = 1; x < 4; x++) for (uint8_t y = x; y > 0 && a[y - 1] > a[y]; y--) { const float t = a[y]; a[y] = a[y - 1]; a[y - 1] = t; }
            end = gate && 0.5f * (a[1] + a[2]) < L.endArg;
          }
          break;
        }
        default:  // END_EFFORT
          end = _eff >= kEffortEnd * L.effort;
          if (!end && gate && !L.gpsBlind && gpsGood(s)) {  // GPS zone may end it a bit earlier
            float e, n;
            enu(s.lat(), s.lon(), L.lat, L.lon, e, n);
            end = e * e + n * n < 4.0f;
          }
          break;
      }
      // ---- LiDAR end match (RouteLocalizer): compare the scan with the taught end scan of the leg
      _loc.endStep(_scan, L.effort > 0 ? _eff / L.effort : 0, gate);
      if (pathLocked()) {   // path mode: the leg ends at the end of the taught path (see the top of _step)
        if (autoAdvance && _eff > 2.5f * L.effort + 3.0f) { _forced++; _nextLeg(s, "path: effort last resort"); }
        return;
      }
      if (endRule == RULE_COMBINED && _loc.hasMap()) {
        if (L.end == END_EFFORT) end = _eff >= kEffortEnd * L.effort;     // no GPS zone
        const bool byLandmark = end && _loc.looksLikeEnd();
        if (byLandmark || _loc.dip()) { _nextLeg(s, byLandmark ? "landmark + scan" : "scan dip"); return; }
        if (autoAdvance && _eff > lastResortFrac * L.effort + 2.0f) {   // last resort: end scan never matched
          _forced++;
          Serial.printf("[route] leg %u: end scan not matched after %.1f/%.1f effort -> next leg\n",
                        (unsigned)(_i + 1), _eff, L.effort);
          _nextLeg(s, "no end match, last resort");
          if (_state == TURN) {
            char m[48];
            snprintf(m, sizeof(m), "leg %u: %s (auto, no end match)", (unsigned)(_i + 1), _cur().name);
            strlcpy(_msg, m, sizeof(_msg));
          }
          return;
        }
        if (!autoAdvance && _eff > maxEffortFrac * L.effort + 4.0f) {
          _overrun = true;
          char why[48];
          snprintf(why, sizeof(why), "leg %u: end not found - check, Resume", (unsigned)(_i + 1));
          pause(why);
        }
        return;
      }
      // ---- RULE_OLD (before 2026-10-28)
      // GPS zone help for every leg (not only EFFORT legs): after the gate, inside 3 m of the
      // taught end point of the leg -> end it, even if the landmark was missed
      if (!end && gate && L.end != END_EFFORT && !L.gpsBlind && gpsGood(s)) {
        float e, n;
        enu(s.lat(), s.lon(), L.lat, L.lon, e, n);
        if (e * e + n * n < 9.0f) { end = true; _forced++; }
      }
      if (end) { _nextLeg(s, "landmark (old rule)"); return; }
      // wall leg whose wall is still there: the corner has not come yet - keep following it longer
      const float lim = (L.end == END_LOST && _lostN < 8 ? 2.5f : advanceEffortFrac) * L.effort + 2.0f;  // wall seen in the last 2 s
      if (autoAdvance && _eff > lim) {
        // landmark not found, but the leg is driven: switch to the next leg automatically
        _forced++;
        Serial.printf("[route] leg %u: no landmark after %.1f/%.1f effort -> next leg\n", (unsigned)(_i + 1), _eff, L.effort);
        _nextLeg(s, "no landmark (old rule)");
        if (_state == TURN) {
          char m[48];
          snprintf(m, sizeof(m), "leg %u: %s (auto, no landmark)", (unsigned)(_i + 1), _cur().name);
          strlcpy(_msg, m, sizeof(_msg));
        }
        return;
      }
      if (!autoAdvance && _eff > maxEffortFrac * L.effort + 4.0f) {
        _overrun = true;
        char why[48];
        snprintf(why, sizeof(why), "leg %u: end not found - check, Resume", (unsigned)(_i + 1));
        pause(why);
      }
      return;
    }
    default:
      _l = _r = 0;
      return;
  }
}
