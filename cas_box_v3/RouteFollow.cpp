#include "RouteFollow.h"
#include <string.h>

// ---------------------------------------------------------------------------------------------
// THE ROUTE, taught in log_027 (2026-11-06, complete path, 139 m, M1-M72, no reversing; the driver's
// turns on the spot do not matter: the legs are built from locations, GEO).
// Generated by   python3 tools/make_legs.py cas_box_log/log_027.csv   - RouteMap.h, LocalPath.h and
// RouteWebMap.h are from the same log: re-make all together. 06.11.: legs from LOCATIONS (GEO, see below). GPS is NOT used (every leg gpsBlind = 1).
// ---------------------------------------------------------------------------------------------
// 15 legs from log_027.csv (tools/make_legs.py). ref = route yaw (gyro frame of the
// teaching run, deg, + = left), dSet m, effort = forward path length / 1 m per effort (GEO, from the LiDAR
// trajectory: not the driver's commands), ref of HOLD legs = direction start -> end, gate, end GPS = zone only
static const RouteFollow::Leg kRoute[] = {
  {RouteFollow::HOLD,  1, RouteFollow::END_EFFORT, 0.00f,     1.6f, 0.00f,  20.8f, 0.75f, 0.0000000, 0.0000000, 1, 0, 0, "M1-M15 heading: corner right"},  // 1: t 2-321 s, GPS 0.0 m
  {RouteFollow::HOLD,  1, RouteFollow::END_EFFORT, 0.00f,   -84.1f, 0.00f,  33.5f, 0.75f, 0.0000000, 0.0000000, 1, 0, 0, "M15-M34 heading: ramp ends right"},  // 2: t 337-721 s, GPS 0.0 m
  {RouteFollow::WALL, -1, RouteFollow::END_LOST, 0.00f,  -182.3f, 1.49f,   5.9f, 0.75f, 0.0000000, 0.0000000, 1, 0, 0, "M34-M38 L wall: wall ends ahead"},  // 3: t 747-825 s, GPS 0.0 m
  {RouteFollow::WALL, -1, RouteFollow::END_FRONT, 1.10f,   -94.1f, 1.07f,   4.2f, 0.90f, 0.0000000, 0.0000000, 1, 0, 0, "M38-M42 L wall: wall starts ahead"},  // 4: t 839-915 s, GPS 0.0 m
  {RouteFollow::WALL, -1, RouteFollow::END_LOST, 0.00f,   -93.2f, 1.22f,   1.4f, 0.75f, 0.0000000, 0.0000000, 1, 0, 0, "M42-M45 L wall: wall ends ahead"},  // 5: t 916-971 s, GPS 0.0 m
  {RouteFollow::HOLD, -1, RouteFollow::END_EFFORT, 0.00f,   -82.4f, 0.00f,  17.5f, 0.75f, 0.0000000, 0.0000000, 1, 0, 0, "M45-M55 heading: ramp ends ahead"},  // 6: t 971-1149 s, GPS 0.0 m
  {RouteFollow::WALL, -1, RouteFollow::END_FRONT, 2.57f,   -93.6f, 2.47f,   2.1f, 0.90f, 0.0000000, 0.0000000, 1, 0, 0, "M55-M57 L wall: wall starts ahead"},  // 7: t 1149-1179 s, GPS 0.0 m
  {RouteFollow::HOLD, -1, RouteFollow::END_EFFORT, 0.00f,   -99.2f, 0.00f,   7.7f, 0.75f, 0.0000000, 0.0000000, 1, 0, 0, "M57-M60 L wall: wall starts ahead"},  // 8: t 1179-1223 s, GPS 0.0 m
  {RouteFollow::HOLD,  1, RouteFollow::END_EFFORT, 0.00f,  -112.9f, 0.00f,   3.8f, 0.75f, 0.0000000, 0.0000000, 1, 0, 0, "M60-M61 heading: corner right"},  // 9: t 1224-1337 s, GPS 0.0 m
  {RouteFollow::WALL, -1, RouteFollow::END_FRONT, 0.57f,  -183.0f, 1.85f,   6.1f, 0.90f, 0.0000000, 0.0000000, 1, 0, 0, "M61-M63 L wall: wall starts ahead"},  // 10: t 1342-1385 s, GPS 0.0 m
  {RouteFollow::WALL, -1, RouteFollow::END_FRONT, 0.55f,  -184.7f, 2.05f,   2.4f, 0.90f, 0.0000000, 0.0000000, 1, 0, 0, "M63-M64 L wall: wall starts ahead"},  // 11: t 1386-1400 s, GPS 0.0 m
  {RouteFollow::WALL, -1, RouteFollow::END_FRONT, 0.69f,  -183.9f, 2.14f,   3.8f, 0.90f, 0.0000000, 0.0000000, 1, 0, 0, "M64-M66 L wall: wall starts ahead"},  // 12: t 1401-1429 s, GPS 0.0 m
  {RouteFollow::WALL, -1, RouteFollow::END_EFFORT, 0.00f,  -183.2f, 2.55f,   6.5f, 0.75f, 0.0000000, 0.0000000, 1, 0, 0, "M66-M69 L wall: wall starts ahead"},  // 13: t 1430-1466 s, GPS 0.0 m
  {RouteFollow::HOLD,  1, RouteFollow::END_EFFORT, 0.00f,  -183.5f, 0.00f,   4.4f, 0.75f, 0.0000000, 0.0000000, 1, 0, 0, "M69-M71 heading: corner right"},  // 14: t 1466-1530 s, GPS 0.0 m
  {RouteFollow::HOLD, -1, RouteFollow::END_EFFORT, 0.00f,  -273.5f, 0.00f,   2.4f, 0.75f, 0.0000000, 0.0000000, 1, 0, 0, "M71-M72 heading: open area ahead"},  // 15: t 1535-1558 s, GPS 0.0 m
};

static const uint8_t kN = sizeof(kRoute) / sizeof(kRoute[0]);
// true bearing (clockwise from north) = kBearingOfRouteYaw0 - routeYaw. From the facade:
// GPS course along B = 125 deg at route yaw kRoute[0].ref (-37.8).
static const float kBearingOfRouteYaw0 = 125.0f + (-37.8f);
static const float kEffortEnd = 0.97f;   // EFFORT legs end here (teaching run zig-zagged a bit)
static const float kMPerDeg = 111194.93f;

uint8_t RouteFollow::count() { return kN; }
const RouteFollow::Leg& RouteFollow::leg(uint8_t i) { return kRoute[i < kN ? i : kN - 1]; }

static bool gpsGood(const Sensors& s) { return s.gpsFix() && s.hdop() > 0 && s.hdop() <= 2.5f; }
static void enu(double lat0, double lon0, double lat1, double lon1, float& e, float& n) {
  n = (float)((lat1 - lat0) * kMPerDeg);
  e = (float)((lon1 - lon0) * kMPerDeg * cos(lat0 * DEG_TO_RAD));
}

// ---------------------------------------------------------------------------------------------

bool RouteFollow::start(const Sensors& s, const WallFollow& wf, uint8_t i, float speed, bool singleLeg) {
  if (i >= kN) i = 0;
  const Leg& L = leg(i);
  // heading anchor: the rover stands parallel to the leg (to its wall on WALL legs)
  if (!s.imuOk()) { strlcpy(_msg, "no IMU", sizeof(_msg)); return false; }
  // v3 START ALIGN: which way is the rover facing? (full-circle match of the scan to the leg map)
  bool aligned = false;
  float ax = 0, ay = 0, ath = 0;
  _alignDeg = 0; _alignSc = 0; _alignSec = 0;
  if (alignStart && pathMode && _lp.legs() == kN) {
    for (uint8_t k = 0; k < Sensors::kLidarPoints; k++) _scan[k] = s.lidarCm(k);
    aligned = _lp.alignSearch(_scan, i, alignMaxOffM, ax, ay, ath, _alignSc, _alignSec);
    _alignDeg = ath * RAD_TO_DEG;
    Serial.printf("[route] start align leg %u: %s, rover %.0f deg off the leg (+ = left), at %.2f/%.2f m, score %.2f (2nd %.2f)\n",
                  (unsigned)(i + 1), aligned ? "OK" : "NOT SURE", _alignDeg, ax, ay, _alignSc, _alignSec);
  }
  if (aligned) {
    _off = _wrap(L.ref + _alignDeg - s.yawDeg());   // route yaw of the rover = leg course + its offset
  } else if (L.kind == WALL) {
    const WallFollow::Wall w = wf.measure(s, L.side < 0 ? WallFollow::LEFT : WallFollow::RIGHT, nullptr);
    if (!w.ok) {
      snprintf(_msg, sizeof(_msg), "leg %u: no wall seen on the %s", (unsigned)(i + 1), L.side < 0 ? "left" : "right");
      return false;
    }
    if (fabsf(w.angleDeg) > startTolDeg) {   // log_0014: started at -54 deg to the wall -> wrong reference
      snprintf(_msg, sizeof(_msg), "start unclear %.2f: turn rover along path", _alignSc);
      return false;
    }
    const float wallYawGyro = L.side < 0 ? s.yawDeg() + w.angleDeg : s.yawDeg() - w.angleDeg;
    _off = _wrap(L.ref - wallYawGyro);
  } else {
    _off = _wrap(L.ref - s.yawDeg());  // rover points along the leg
  }
  _i = i;
  _loc.enabled = RouteLocalizer::mapLegs() == kN;  // map from another teaching run: do not use it
  if (!_loc.enabled)
    Serial.printf("[route] RouteMap.h has %u legs, kRoute %u - LiDAR end match OFF (old rule). "
                  "Re-run tools/make_segments.py + make_legs.py\n", (unsigned)RouteLocalizer::mapLegs(), (unsigned)kN);
  _loc.beginLeg(i);
  _lpOn = pathMode && _lp.legs() == kN;   // LocalPath.h from the same teaching run as kRoute
  if (_lpOn) _lp.begin(i);                // rover at the start of leg i, pointing along it
  if (_lpOn && aligned) _lp.setPose(ax, ay, ath);   // v3: the pose the start align found
  _lpYawPrev = s.yawDeg();
  _lpEffAcc = 0;
  _pitch0 = s.pitchDeg();
  _roll0 = s.rollDeg();
  _slopeMs = 0; _xteI = 0; _ey = 0; _peInit = false; _noTurnEff = -99;
  _lpOkMs = 0;
  _speed = speed;
  _hasRun = true;
  _eff = 0; _I = 0; _seen = _lostN = _foundN = _frN = 0; _lowN = 0; _pivoting = false; _yawDesInit = false; _climbN = 0; _climbUntil = 0;
  _avTries = 0; _stuckN = 0; _backups = 0; _refMs = 0; _overrun = false; _passEff = -99; _forced = 0;
  _wN = 0; _drift = 0; _pivotEndMs = 0; _tapPh = 0; _tapGain = tapGain0;
  _stopAfter = singleLeg ? i : 255;
  _endInfo[0] = 0;
  _lmkBegin();
  // v3: facing off the leg -> first turn on the spot (TURN state, gyro-closed soft pivot), then drive
  _state = (aligned && fabsf(_alignDeg) > turnDoneDeg) ? TURN : DRIVE;
  _startTurn = _state == TURN; _startRounds = 0; _stepTgt = NAN; _settleMs = 0; _netM = 0;
  _stateMs = _lastStep = millis();
  if (_state == TURN) snprintf(_msg, sizeof(_msg), "start: facing %.0f deg off - turning", _alignDeg);
  else snprintf(_msg, sizeof(_msg), "leg %u: %s", (unsigned)(i + 1), L.name);
  return true;
}

bool RouteFollow::resume(float speed) {
  if (!canResume()) return false;
  _speed = speed;
  if (_overrun) {  // paused because the landmark was not found: accept it from now on
    _eff = fminf(_eff, _cur().gate * _cur().effort);
    _overrun = false;
  }
  _state = _resumeState == TURN ? TURN : DRIVE;
  _stuckN = 0; _refMs = 0; _I = 0; _lowN = 0; _pivoting = false; _yawDesInit = false; _tapPh = 0;
  _stateMs = millis();
  snprintf(_msg, sizeof(_msg), "resumed leg %u: %s", (unsigned)(_i + 1), _cur().name);
  return true;
}

void RouteFollow::pause(const char* why) {
  if (_state == OFF || _state == DONE) return;
  if (_state != PAUSED) _resumeState = _state;
  _state = PAUSED;
  _l = _r = 0;
  if (why != _msg) strlcpy(_msg, why, sizeof(_msg));
  Serial.printf("[route] pause: %s\n", why);
}

void RouteFollow::feedOutput(float l, float r) {
  const uint32_t now = millis();
  const float dt = (now - _lastOut) / 1000.0f;
  _lastOut = now;
  if (!active() || dt > 0.5f) return;
  const float v = 0.5f * (l + r);
  _outV = v;                                  // what REALLY went to the wheels (stuck check)
  _outW = 0.5f * (r - l);                     // turn that really went to the wheels (pivot stuck check)
  if (v > 0) { _eff += v * dt; _lpEffAcc += v * dt; }
  _odo += v * dt;                             // 12.11.: signed (backward counts minus) - detour dead reckoning
}

// path heading error (rad, + = left): straight line to the next corner of the taught path at least
// pathLookM ahead (lineLook), or the pure-pursuit point pathLookM ahead
float RouteFollow::_pathErrRad() const {
  // 06.11.: adaptive look-ahead + crab + cross-track integral (see RouteFollow.h)
  const float sc = _clamp(_lp.score(), 0.0f, 1.0f);
  const float Ld = _clamp(lookTimeS * fabsf(_outV), lookMinM, lookMaxM) + lookScoreM * (1.0f - sc);
  float e = lineLook ? _lp.headingErrorToWaypoint(Ld) : _lp.headingErrorTo(Ld);
  if (_outV > 0.1f) e += (-crabDeg + _xteI) * DEG_TO_RAD;   // only while rolling forward
  const Leg& L = _cur();
  if (L.kind == HOLD) {   // 06.11.: within +-holdTolDeg of the IMU heading ref (route yaw of this step)
    const float lo = _wrap(L.ref - holdTolDeg - _stepRy) * DEG_TO_RAD, hi = _wrap(L.ref + holdTolDeg - _stepRy) * DEG_TO_RAD;
    if (lo <= hi) e = _clamp(e, lo, hi);
  }
  return e;
}

// Steer on the LiDAR-localised taught path? Not on yaw-only legs (open area / ramp, see yawLegs):
// there the rover holds the taught heading (route yaw = relative gyro yaw + offset) instead.
bool RouteFollow::_pathSteer() const {
  return pathLocked() && !_lmkOn && !((yawLegs >> _i) & 1u) && (_cur().kind != HOLD || _lp.score() >= minPathScore);
}

bool RouteFollow::pathLocked() const {
  return _lpOn && _lp.lostN() < 8 && _lpOkMs != 0 && millis() - _lpOkMs < 3000;
}

void RouteFollow::steer(const Sensors& s, const WallFollow& wf, float& l, float& r) {
  const uint32_t now = millis();
  if (now - _lastStep >= 250) {  // one step per sensor snapshot (4 Hz): targets, legs, obstacles
    _lastStep = now;
    _ctrlOn = false;             // a step that does not call _drive sets _l / _r itself (wait, back up)
    _step(s, wf);
  }
  if (_ctrlOn && active()) _control(s);   // heading controller on the live gyro yaw, every pass
  else {
    if (_pivoting) { _pivoting = false; _pivotEndMs = now; }   // the step drives itself: pivot off
    _hc = 0;
    _why = WHY_STEP;
  }
  l = _l;
  r = _r;
}

// ---------------------------------------------------------------------------------------------

bool RouteFollow::_wallNow(const Sensors& s, const WallFollow& wf, int8_t side, float& d, float& dirYaw,
                           float& rms, uint8_t& pts) const {
  const WallFollow::Wall w = wf.measure(s, side < 0 ? WallFollow::LEFT : WallFollow::RIGHT, nullptr);
  if (!w.ok || w.points < 6) return false;
  const float ry = routeYaw(s);
  dirYaw = _wrap(side < 0 ? ry + w.angleDeg : ry - w.angleDeg);  // direction of the wall line
  d = w.distM; rms = w.rmsM; pts = w.points;
  return true;
}

// Free length (m) of a corridor 2*half wide in direction phi (+ = right of the nose), up to look.
// Uses the SECOND closest point: one stray LiDAR point does not block the way (log_011: 30 false
// obstacle stops on legs 1-2 from single points 25-66 cm away). Returns < 25 cm are ignored
// (SafetyGuard handles really close things).
float RouteFollow::_corridor(const Sensors& s, float phiDeg, float half, float look) const {
  float b1 = look, b2 = look;
  for (uint8_t i = 0; i < Sensors::kLidarPoints; i++) {
    const uint16_t cm = s.lidarCm(i);
    if (cm < 25) continue;
    const float a = (i * 4.0f + 2.0f - phiDeg) * DEG_TO_RAD, rr = cm / 100.0f;
    const float along = rr * cosf(a), lat = rr * sinf(a);
    if (along <= 0 || fabsf(lat) >= half) continue;
    if (along < b1) { b2 = b1; b1 = along; } else if (along < b2) b2 = along;
  }
  return b2;
}

float RouteFollow::_front(const Sensors& s) const { return _corridor(s, 0, 0.35f, 1.5f); }

// Median change (cm) of the LiDAR points between now and the reference scan of 2 s ago.
float RouteFollow::_scanChangeCm(const Sensors& s) const {
  uint8_t hist[64] = {0};
  uint8_t n = 0;
  for (uint8_t i = 0; i < Sensors::kLidarPoints; i++) {
    const uint16_t a = s.lidarCm(i), b = _ref[i];
    if (a < 25 || b < 25 || a > 500 || b > 500) continue;
    int d = abs((int)a - (int)b);
    if (d > 63) d = 63;
    hist[d]++;
    n++;
  }
  if (n < 15) return 99;  // too few points to tell: count as moving
  uint8_t c = 0;
  for (uint8_t k = 0; k < 64; k++) { c += hist[k]; if (c > n / 2) return k; }
  return 63;
}

// Sets the target for _control: e = wanted - current heading (deg, + = left), v = forward command,
// fwd = roll forwards (else backwards, e.g. obstacle ahead). Called from the 4 Hz _step.
void RouteFollow::_drive(float e, float v, bool fwd) {
  _tgtYaw = _wrap(_stepRy + e);              // absolute target, from the snapshot heading of this step
  _tgtV = v;
  _tgtFwd = fwd;
  _ctrlOn = true;
}

// Heading controller, every loop pass (max 100 Hz), on the LIVE gyro yaw (Sensors::yawNowDeg).
// REWRITTEN 2026-11-04 (demo 03.11.: "too jerky", gears worn) - adapted from Kethan's field-tested
// forward heading hold (cas_box_kethan, steerForward):
//   ROLLING  (|e| < pivotDeg): gentle wheel difference, PD on the error, D on the measured yaw rate
//            (no kick when the target changes):  c = hKp * e - hKd * rate   (e inside +-0.5 deg -> 0)
//            |c| <= min(corrMax, corrFrac * speed), c changes by at most corrRate per second
//            l = base - c,  r = base + c       -> no pivots, no taps, no zig-zag
//            (log_014 "a wheel difference does not turn it" was with the old MotorShaper, which
//            squeezed every difference by its dead band, and a 10x smaller gain.)
//   PIVOT    (|e| >= pivotDeg, or not rolling forward and |e| > turnDoneDeg): soft pivot at pivotCmd
//            (0.35, ramped by MotorShaper), released early by what it still turns after the release
//            (|rate| * pivotCoastS) - the small rest is done by the rolling PD.
//   no valid gyro sample (Sensors::imuOk) -> stand (MotorShaper brakes softly).
// The old tap-and-settle controller (pivots at 0.5) is gone; arcMax / kP / kI are unused.
void RouteFollow::_control(const Sensors& s) {
  const uint32_t now = millis();
  if (_ctrlMs != 0 && now - _ctrlMs < 10) return;          // 100 Hz; _l / _r stay
  const float dt = _ctrlMs == 0 ? 0 : (now - _ctrlMs) / 1000.0f;
  _ctrlMs = now;
  if (!s.imuOk()) {                                         // no checked gyro sample for 0.5 s
    _l = _r = 0; _hc = 0; _pivoting = false; _why = WHY_STAND;
    strlcpy(_msg, "IMU invalid - standing", sizeof(_msg));
    return;
  }
  const float y = _wrap(s.yawNowDeg() + _off);              // live route yaw
  if (dt > 0 && dt < 0.1f) {
    const float keep = powf(0.7f, dt / 0.02f);              // ~0.06 s low-pass on the yaw rate
    _rate = keep * _rate + (1.0f - keep) * _wrap(y - _prevYaw) / dt;
  } else {
    _rate = 0;
  }
  _prevYaw = y;
  const float base = _tgtFwd ? _tgtV : 0.0f;                // blocked ahead: turn on the spot, no roll
  // (MotorShaper ramps the speed down before a pivot and back up after it: no step on the gears)
  const float e = _wrap(_tgtYaw - y);
  _ctrlErr = e;
  const float ae = fabsf(e);
  const int8_t dir = e > 0 ? 1 : -1;                        // + = turn left

  // ---- soft pivot
  // 11.11.: after a pivot let it settle 0.6 s before the next one (Kethan's stop-and-check; the early release left
  // ~10 deg and the next pivot started at once - 14 restarts for one 83 deg turn in the sim)
  if (!_pivoting && (ae >= pivotDeg || (!_tgtFwd && ae > turnDoneDeg)) && (ae >= pivotDeg + 20.0f || now - _pivotEndMs > 600)) {
    _pivoting = true; _pivotMs = now; _tapDir = dir; _hc = 0; _pivBoost = 0;
    if (turnTactics) { _netM = 0; _kDir = 0; _kYaw0 = s.yawNowDeg(); _tacStart((rollStart && fabsf(_outV) < 0.12f) ? TK_ROLL : TK_PIVOT, s, now, true); }   // 13.11.: standing -> roll first (log_037 M15)
  }
  if (_pivoting) {
    const float coast = fminf(14.0f, fabsf(_rate) * pivotCoastS);  // still turns this much after the release (Kethan: 14 deg at 0.35)
    const bool done = ae <= fmaxf(pivotDoneDeg, coast) || dir != _tapDir;
    if (!done) {
      if (turnTactics) { _tactic(s, dt, now); return; }
      // old way (turnTactics = false): soft pivot raised gently to 0.50, then a swing
      if (now - _pivotMs > 1500 && fabsf(_rate) < 3.0f && dt > 0 && dt < 0.1f)
        _pivBoost = fminf(pivotBoostMax, _pivBoost + pivotBoostRate * dt);
      const float pc = pivotCmd + _pivBoost;
      if (_pivBoost >= pivotBoostMax && now - _pivotMs > swingAfterMs && fabsf(_rate) < 3.0f) {
        const float f = _tgtFwd ? pc : -pc;
        if (_tapDir > 0) { _l = 0; _r = f; } else { _l = f; _r = 0; }
        _why = WHY_TAP;
        return;
      }
      _l = _tapDir > 0 ? -pc : pc; _r = -_l;
      _why = WHY_TAP;
      return;
    }
    _pivoting = false; _pivotEndMs = now; _tk = TK_NONE;
  }

  // ---- rolling: PD heading hold (Kethan)
  // v4b: on the smooth reroute curve a bigger wheel difference (the curve is planned for it)
  const float limit = rerouting() ? fminf(rrCorrMax, 0.8f * fabsf(base)) : fminf(corrMax, corrFrac * fabsf(base));
  const float want = _clamp((ae > 0.5f ? hKp * e : 0.0f) - hKd * _rate, -limit, limit);
  if (dt <= 0 || dt >= 0.1f) _hc = 0;
  else _hc += _clamp(want - _hc, -corrRate * dt, corrRate * dt);
  _hc = _clamp(_hc, -limit, limit);
  // v3 (10.11., from Arjun's DriveStraight, field-tested on rover 7): TRIM LEARNING. A rover that keeps pulling
  // to one side needs a constant correction - with the cap of 0.10 a strong puller (rover 7: trim +0.25..+0.55)
  // saturates the hold and drifts off. The steady part of _hc is moved slowly into a wheel trim (time constant
  // trimTauFastS for the first 40 s of driving, then trimTauS), the same amount leaves _hc (output unchanged at
  // that moment); only rolling straight with a small error (no learning from turns or bumps).
  if (trimLearn && base > 0.1f && ae < trimLearnBelowDeg && dt > 0 && dt < 0.1f) {
    const float tau = trimTauFastS + (trimTauS - trimTauFastS) * fminf(1.0f, _driveS / 40.0f);
    const float nt = _clamp(trim + (_hc / base) * dt / tau, -trimMax, trimMax);
    _hc -= (nt - trim) * base;
    trim = nt;
  }
  if (base > 0.1f && dt > 0 && dt < 0.1f) _driveS += dt;
  _l = base - _hc - base * trim;            // trim: + = more on the right wheel (turns left), like Arjun's RoverTrim
  _r = base + _hc + base * trim;
  _why = _tgtFwd ? WHY_ROLL : WHY_STAND;
}

// Keeps the last 5 wall readings of this leg; a reading more than wallJumpDeg off their median is
// dropped (one scan that fits a corner, a gap or a bench). d / wy become the medians.
bool RouteFollow::_wallFilter(float& d, float& wy) {
  if (_wN >= 3) {
    float a[5];
    for (uint8_t k = 0; k < _wN; k++) a[k] = _wrap(_wyBuf[k] - wy);
    for (uint8_t x = 1; x < _wN; x++) for (uint8_t q = x; q > 0 && a[q - 1] > a[q]; q--) { const float t = a[q]; a[q] = a[q - 1]; a[q - 1] = t; }
    if (fabsf(a[_wN / 2]) > wallJumpDeg) { _wRej++; if (_wRej < 4) return false; _wN = 0; }  // 4 in a row: the wall really turned
  }
  _wRej = 0;
  _wyBuf[_wI] = wy; _dBuf[_wI] = d; _wI = (_wI + 1) % 5; if (_wN < 5) _wN++;
  float a[5], b[5];
  for (uint8_t k = 0; k < _wN; k++) { a[k] = _wrap(_wyBuf[k] - wy); b[k] = _dBuf[k]; }
  for (uint8_t x = 1; x < _wN; x++) for (uint8_t q = x; q > 0 && a[q - 1] > a[q]; q--) { const float t = a[q]; a[q] = a[q - 1]; a[q - 1] = t; }
  for (uint8_t x = 1; x < _wN; x++) for (uint8_t q = x; q > 0 && b[q - 1] > b[q]; q--) { const float t = b[q]; b[q] = b[q - 1]; b[q - 1] = t; }
  wy = _wrap(wy + a[_wN / 2]);
  d = b[_wN / 2];
  return true;
}

void RouteFollow::_nextLeg(const Sensors& s, const char* how) {
  const Leg& L = _cur();
  char warn[24] = "";
  if (!L.gpsBlind && gpsGood(s)) {  // GPS = approximate zone only
    float e, n;
    enu(L.lat, L.lon, s.lat(), s.lon(), e, n);
    const float dz = sqrtf(e * e + n * n);
    if (dz > zoneWarnM) snprintf(warn, sizeof(warn), " (GPS %.0f m off)", dz);
  }
  char sc[40] = "no end scan yet";   // end-scan match: now / base level of the leg (cm, lower = closer)
  if (_loc.costNow() >= 0)
    snprintf(sc, sizeof(sc), "scan %.0f/%.0f cm%s", _loc.costNow(), _loc.base(), _loc.dip() ? " dip" : "");
  Serial.printf("[route] leg %u done (%s), effort %.1f/%.1f, %s%s, drift %.1f deg/s, trim %.3f\n", (unsigned)(_i + 1), how, _eff, L.effort, sc, warn, _drift, trim);
  if (_lpOn && _lp.leg() == _i && _i + 1 < kN) _lp.nextLeg();   // keep the local frame on the same leg
  _peInit = false; _noTurnEff = -99;
  snprintf(_endInfo, sizeof(_endInfo), "leg %u: %s, effort %.0f %%, %s%s", (unsigned)(_i + 1), how,
           L.effort > 0 ? 100.0f * _eff / L.effort : 0.0f, sc, warn);
  if (_i == _stopAfter) {             // segment test: this leg only
    _state = DONE;
    _l = _r = 0;
    snprintf(_msg, sizeof(_msg), "leg %u test done (%s)", (unsigned)(_i + 1), how);
    return;
  }
  if (_i + 1 >= kN) {
    _state = DONE;
    _l = _r = 0;
    snprintf(_msg, sizeof(_msg), "route done (%s)%s", how, warn);
    return;
  }
  _i++;
  _loc.beginLeg(_i);
  _eff = 0; _I = 0; _seen = _lostN = _foundN = _frN = 0; _lowN = 0; _pivoting = false; _yawDesInit = false;
  _avTries = 0; _backups = 0; _stuckN = 0; _passEff = -99; _wN = 0; _vetoLogged = false; _climbN = 0; _climbUntil = 0;
  _lmkBegin();
  _state = TURN;
  _stateMs = millis();
  snprintf(_msg, sizeof(_msg), "leg %u: %s%s", (unsigned)(_i + 1), _cur().name, warn);
}

void RouteFollow::_step(const Sensors& s, const WallFollow& wf) {
  if (!active()) { _l = _r = 0; return; }
  const Leg& L = _cur();
  const uint32_t now = millis();
  const float ry = routeYaw(s);
  _stepRy = ry;
  // ---- local path localisation: every step, in every state (turns and obstacles included)
  if (_lpOn) {
    // v4: during a detour the rover is off the taught path on purpose - the scan match still works there (sim:
    // score 0.85 at 0.8 m off), but the 1 m relocation rule snapped the pose back onto the path
    _lp.relocOffM = (_state == AVOID && (_avPhase >= 1 || _avMid)) ? 1.8f : 1.0f;
    for (uint8_t k = 0; k < Sensors::kLidarPoints; k++) _scan[k] = s.lidarCm(k);
    const float dy = _wrap(s.yawDeg() - _lpYawPrev) * DEG_TO_RAD;
    _lpYawPrev = s.yawDeg();
    _lp.step(_scan, dy, _lpEffAcc, fabsf(s.pitchDeg() - _pitch0) >= 5.0f);
    _lpEffAcc = 0;
    if (_lp.ok()) _lpOkMs = now;
    // 06.11. (replay of log_026): "path end" alone ended legs far too early - legs whose taught path is
    // only ~1 m (corners turned almost on the spot: legs 1, 3, 7, 11) ended at 2-25 % of their taught
    // distance, so the rover skipped the corner at building C. Now the path end counts only after
    // pathEndMinFrac of the taught effort, and never on yaw-only legs (LiDAR position unreliable there).
    const bool yawLeg = (yawLegs >> _i) & 1u;
    if (_lp.atEnd() && !yawLeg && !_lmkOn && _eff >= pathEndMinFrac * L.effort && (_state == DRIVE || _state == TURN)) {
      _nextLeg(s, "path end"); return;
    }
  }

  // ---- ground / progress: median change of the LiDAR points against the last snapshot (0.25 s).
  // Rolling straight but the scene does not move (< 1 cm) for 3 steps: rough ground, grass, a ramp
  // foot -> boost the forward command a little more every step (MotorShaper adds it); moving again
  // (>= 2 cm) -> boost back down. Never downhill (front down > 4 deg: gravity does it).
  {
    float d[Sensors::kLidarPoints];
    uint8_t m = 0;
    for (uint8_t k = 0; k < Sensors::kLidarPoints; k++) {
      const uint16_t a = s.lidarCm(k), c = _prevScan[k];
      if (a > 25 && c > 25 && a < 500 && c < 500) d[m++] = fabsf((float)a - (float)c);
      _prevScan[k] = a;
    }
    float med = 99;
    if (m >= 15) {
      for (uint8_t x = 1; x < m; x++) for (uint8_t q = x; q > 0 && d[q - 1] > d[q]; q--) { const float t = d[q]; d[q] = d[q - 1]; d[q - 1] = t; }
      med = d[m / 2];
    }
    _progCm = med;
    const bool rolling = _state == DRIVE && _why == WHY_ROLL && _l > 0.05f && _r > 0.05f;
    if (rolling && med < 1.0f && s.pitchDeg() < 4.0f) { if (_noProgN < 255) _noProgN++; } else _noProgN = 0;
    if (_noProgN >= boostAfterSteps) _boost = fminf(boostMax, _boost + boostStep);   // stuck 2 s: gentle push
    else if (!rolling || med >= 2.0f) _boost = fmaxf(0.0f, _boost - 2.0f * boostStep);
  }

  // ---- 06.11.: on the slope? (ramp mode, see onRamp)
  if (fabsf(s.pitchDeg() - _pitch0) > slopeDeg) _slopeMs = now ? now : 1;
  // ---- 06.11.: cross-track error and its integral (path mode, rolling forward)
  if (_lpOn && pathLocked()) {
    _ey = _lp.crossTrack();
    _Ld = _clamp(lookTimeS * fabsf(_outV), lookMinM, lookMaxM) + lookScoreM * (1.0f - _clamp(_lp.score(), 0.0f, 1.0f));
    if (_state == DRIVE && _pathSteer() && _outV > 0.15f && fabsf(_ey) < 1.0f)
      _xteI = _clamp(_xteI - xteKi * _ey * 0.25f, -xteIMaxDeg, xteIMaxDeg);
  }

  // ---- stuck detection: commanded to move for the whole 2 s, but the scene did not change
  // "moving" = what REALLY went to the wheels (after the ramp and SafetyGuard), not what the route
  // asked for: while the speed ramps up from standstill the rover is not stuck (field test 05.11.)
  // 06.11.: a pivot only counts when the turn REALLY reaches the wheels (a guard stop holds them at 0 ->
  // that was "stuck (out 0.00) - backing up" although nothing was commanded to the motors)
  // v3: while the turn tactics run they handle a stalled turn themselves (log_030: 5 back-ups during the
  // start turn -> PAUSE "stuck" after 50 s)
  const bool moving = !(_pivoting && turnTactics) &&
                      (fabsf(_outV) >= stuckMinOut || (_pivoting && fabsf(_outW) >= stuckMinTurn));
  if (_refMs == 0 || now - _refMs >= 2000) {
    if (_refMs && _refMoving && moving && _state != BACKUP) {
      const float ch = _scanChangeCm(s);
      const float dy = fabsf(_wrap(s.yawDeg() - _refYaw));
      _stuckN = (ch < 2.5f && dy < 3.0f) ? _stuckN + 1 : 0;
    } else {
      _stuckN = 0;
    }
    for (uint8_t i = 0; i < Sensors::kLidarPoints; i++) _ref[i] = s.lidarCm(i);
    _refYaw = s.yawDeg();
    _refMs = now;
    _refMoving = moving;
  } else {
    _refMoving = _refMoving && moving;
  }
  if (_stuckN >= stuckWindows) {
    _stuckN = 0;
    // 11.11. (log_032 M47/48: rear wheels hanging on a step, the heading hold kept one side at 0.09): first push
    // STRAIGHT on both wheels (climbPow, no steering) for climbMs, twice per leg - then back up as before
    if (_climbN < 2) {
      _climbN++;
      _state = BACKUP; _stateMs = now; _climbUntil = now + climbMs;
      snprintf(_msg, sizeof(_msg), "stuck - climb push %u", (unsigned)_climbN);
      Serial.println("[route] stuck -> climb push (straight)");
      return;
    }
    if (++_backups >= maxBackups) { pause("stuck - help me, then Resume"); return; }
    _state = BACKUP;
    _stateMs = now;
    snprintf(_msg, sizeof(_msg), "stuck (v %.2f w %.2f) - backing up", _outV, _outW);
    Serial.println("[route] stuck -> back up");
  }
  // 12.11. (tools/sim_v3): the SafetyGuard holds the wheels (something < 30 cm ahead) while the route keeps asking
  // forward -> nothing moves, the stuck check above never counts (it needs moving wheels) = endless wait. After 2.5 s
  // back up (if the rear is free), then the route tries again.
  if (_state == DRIVE && 0.5f * (_l + _r) > 0.05f && fabsf(_outV) < 0.01f) { if (!_guardMs) _guardMs = now; }
  else _guardMs = 0;
  if (_guardMs && now - _guardMs > 2500) {
    _guardMs = 0;
    if (++_backups >= maxBackups) { pause("held by the safety stop - help me, then Resume"); return; }
    if (_rearFree(s)) {
      _state = BACKUP; _stateMs = now; _climbUntil = 0;
      strlcpy(_msg, "held by the safety stop - backing up", sizeof(_msg));
      Serial.println("[route] safety stop holds the wheels -> back up");
    }
  }

  switch (_state) {
    case BACKUP:
      if (now < _climbUntil) { _l = _r = climbPow; return; }               // climb push first
      if (_climbUntil != 0 && now - _climbUntil < 300) { _l = _r = 0; return; }
      if (_climbUntil != 0) { _climbUntil = 0; _state = DRIVE; return; }   // after the push: drive on (check again)
      // 12.11. (found with tools/sim_v3): the climb-push change of 11.11. had deleted this line - since then "backing
      // up" never reversed, it kept the last command (often forward into the wall)
      _l = _r = -backupCmd;
      if (now - _stateMs >= 2500) { _state = DRIVE; _l = _r = 0; }
      return;

    case TURN: {
      if (_startTurn) { _startTurnStep(s, ry, now); return; }   // v3: start alignment (90 deg steps + re-check)
      // path mode: turn towards the taught path 1 m ahead, else to the leg direction
      const float e = _pathSteer() ? _pathErrRad() * RAD_TO_DEG : _wrap(L.ref - ry);
      if (fabsf(e) < turnDoneDeg && !_pivoting) { _state = DRIVE; return; }
      // 06.11.: never hang in TURN (heading not reachable, blocked, ramp foot): after turnTimeoutMs drive the
      // leg anyway - the rolling heading hold keeps correcting, the leg-end checks run again
      if (now - _stateMs > (turnTactics ? turnTacticTimeoutMs : turnTimeoutMs)) {
        _state = DRIVE; _pivoting = false; _hc = 0; _noTurnEff = _eff; _stateMs = now;
        snprintf(_msg, sizeof(_msg), "leg %u: turn time-out, driving on", (unsigned)(_i + 1));
        Serial.printf("[route] leg %u: turn not finished after %u ms (err %.0f deg) -> drive\n", (unsigned)(_i + 1), (unsigned)turnTimeoutMs, e);
        return;
      }
      _drive(e, _speed, _front(s) > 0.6f);  // _control pivots on the gyro until the heading is reached
      return;
    }

    case AVOID: {
      if (smartAvoid) { _avoidSmart(s, L, ry, now); return; }   // v4
      const float fr = _front(s);
      if (_avPhase == 0) {                     // wait: people / bikes pass by
        _l = _r = 0;
        for (uint8_t i = 0; i < Sensors::kLidarPoints; i++) _scan[i] = s.lidarCm(i);
        // path mode: free again = nothing NEW (not in the leg map) in the corridor ahead; mapped walls
        // close to the taught path are fine (you drove past them in the teaching run)
        const bool lpFree = pathLocked() && _corridor(s, 0, 0.18f, 1.5f) > lpStopM + 0.05f && _lp.newPointsAhead(_scan, 0.35f, avoidEnterM) < 2;
        const bool lpTurn = _pathSteer() && fabsf(_pathErrRad()) * RAD_TO_DEG > 2.0f * turnDoneDeg + 12.0f;
        if (lpTurn) { _state = TURN; _stateMs = now; return; }
        if (lpFree || fr > avoidFreeM - 0.2f) { _state = DRIVE; strlcpy(_msg, "way free again", sizeof(_msg)); return; }
        if (now - _stateMs < 3000) return;
        // closest free direction, never right where the open edge is
        float best = 999;
        for (int a = 20; a <= 60 && best > 900; a += 10) {
          for (int sg = -1; sg <= 1; sg += 2) {
            const float phi = sg * a;          // + = right
            if (phi > 0 && L.noRight) continue;
            if (_corridor(s, phi, 0.35f, 1.5f) >= avoidFreeM) { best = phi; break; }
          }
        }
        if (best > 900) {
          if (++_avTries >= 3) { pause("blocked - help me, then Resume"); return; }
          _stateMs = now;                      // wait another 3 s
          strlcpy(_msg, "blocked - waiting", sizeof(_msg));
          return;
        }
        _avTarget = _wrap(ry - best);          // yaw + = left
        _avPhase = 1;
        strlcpy(_msg, best < 0 ? "obstacle - passing left" : "obstacle - passing right", sizeof(_msg));
        return;
      }
      if (_avPhase == 1) {                     // turn to the free direction (roll BACK between taps)
        const float e = _wrap(_avTarget - ry);
        if (fabsf(e) < turnDoneDeg && !_pivoting) { _avPhase = 2; _avEff = _eff; _l = _r = 0; return; }
        _drive(e, _speed, false);
        return;
      }
      if (_avPhase == 2) {                     // sidestep until the leg direction is free
        if (fr < avoidEnterM || _eff - _avEff > 3.0f) { _avPhase = 0; _stateMs = now; _l = _r = 0; return; }
        const float back = _corridor(s, -_wrap(L.ref - ry), 0.35f, 1.5f);  // along the leg (+ = right)
        if (_eff - _avEff > 0.4f && (back >= 1.45f || pathLocked())) { _avPhase = 3; _l = _r = 0; return; }
        _drive(_wrap(_avTarget - ry), _speed, true);
        return;
      }
      {                                        // phase 3: turn back parallel to the leg / towards the path
        const float e = _pathSteer() ? _pathErrRad() * RAD_TO_DEG : _wrap(L.ref - ry);
        if (fabsf(e) < turnDoneDeg && !_pivoting) {
          _state = DRIVE; _passEff = _eff; _l = _r = 0;
          strlcpy(_msg, "obstacle passed", sizeof(_msg));
          return;
        }
        _drive(e, _speed, fr > 0.6f);
        return;
      }
    }

    case DRIVE: {
      // ---- obstacle ahead
      for (uint8_t i = 0; i < Sensors::kLidarPoints; i++) _scan[i] = s.lidarCm(i);
      const float fr = _front(s);
      // path mode: pointing well away from the taught path (leg hand-over at a corner, after passing
      // an obstacle) -> pivot on the spot first; the wall it is facing is not in the way of the path
      if (_pathSteer() && fabsf(_pathErrRad()) * RAD_TO_DEG > 2.0f * turnDoneDeg + 12.0f &&
          _eff - _noTurnEff > noTurnAfterTimeoutEff) {
        _state = TURN; _stateMs = now; _l = _r = 0; return;   // 06.11.: the turn timer starts NOW
      }
      // closer than hardStopM: ALWAYS handle it (log_014: the static filter let it drive into a wall the
      // teaching run had also seen - in the teaching run you turned before it). A leg that ends at a wall
      // ahead (END_FRONT) ends here.
      const bool ramp = onRamp();   // 06.11.: ramp leg AND on the slope now (was: the whole ramp leg)
      // v4b: a new thing seen EARLY (up to rrLookM, 2 scans in a row) -> smooth reroute without stopping
      if (smartAvoid && smoothReroute && !ramp && !_lmkOn && pathLocked() && _lp.score() >= avMinScore) {
        float nl = 0;
        for (uint8_t k = 0; k < Sensors::kLidarPoints; k++) _scan[k] = s.lidarCm(k);
        const float fn = _lp.newAhead(_scan, 0.35f, rrLookM, &nl);
        if (fn < rrLookM && fn > 1.2f) { if (_rrN < 255) _rrN++; } else _rrN = 0;
        if (_rrN >= 2 && !(L.end == END_FRONT && _eff >= 0.3f * L.effort) && _rrTry(s, L, ry, fn, nl, now)) { _rrN = 0; return; }
      }
      // path mode, locked: walls of the taught map only count closer than 0.25 m (you drove the
      // teaching run within 5-25 cm of things in places); NEW things (not in the map) at hardStopM
      // (narrow corridor 0.18 m = rover half width + 5 cm: the teaching run passed walls that close)
      const bool lpk = pathLocked() && _lp.newPointsAhead(_scan, 0.35f, hardStopM) < 2;
      // log_020 leg 9 end: drove into a mapped structure to 20 cm (the old 0.20 here) - the teaching run
      // had turned before it. Mapped walls in the rover-wide corridor now stop at lpStopM.
      const float hs = lpk ? lpStopM : hardStopM;
      const float frStop = lpk ? _corridor(s, 0, 0.18f, 1.5f) : fr;
      if (!ramp && frStop < hs) {
        if (L.end == END_FRONT && _eff >= 0.3f * L.effort) { _nextLeg(s, "wall ahead reached"); return; }
        _lowN = 1;   // with this pass: 2 -> obstacle handling now
      }
      bool blocked = lpk ? frStop < hs : fr < avoidEnterM;
      // something ahead that the teaching run also saw there (wall at a turn, railing, ramp edge)
      // is static: drive on - but only if it is still farther than hardStopM. Only >= 2 NEW points
      // start the obstacle handling.
      if (blocked && !lpk && fr >= hs && staticFilter) {
        if (pathLocked()) blocked = _lp.newPointsAhead(_scan, 0.35f, avoidEnterM) >= 2;   // vs the leg map (cm-exact)
        else if (_loc.hasMap()) blocked = _loc.newPointsAhead(_scan, 0.35f, avoidEnterM) >= 2;
      }
      // 06.11. (log_028 pole): the front ultrasonic is an obstacle sensor too - the LiDAR misses thin
      // things close up (< 25 cm). Not on the slope (it sees the ramp surface there).
      const int usf = s.usCm(0);
      if (!ramp && usf > 2 && usf < usStopCm) blocked = true;
      // v4: a NEW thing (not in the leg map) on the locked path counts from avoidPlanM (1.5 m), not only inside
      // hardStopM - with the 2 s S-curve stop the rover rolled ~0.3 m into it (obstacle_sim scenario 1)
      // (only with a reliable match: with a weak one mapped walls land beside their cells and look new -
      // replay of log_027: 11 false starts, 7 of them at score < 0.6 or at a leg start with people around)
      float farNew = 99;
      if (smartAvoid && !ramp && _lp.score() >= avMinScore) farNew = _newAhead(s, avoidPlanM, nullptr);
      if (farNew < avoidPlanM) blocked = true;
      if (ramp) blocked = false;
      _lowN = blocked ? (uint8_t)(_lowN + 1) : 0;
      // two scans in a row: a real obstacle; three if it is only seen far ahead (> 0.9 m) - still >= 1.2 m left
      if (_lowN >= (farNew < avoidPlanM && farNew > 0.9f && frStop >= hs && fr >= avoidEnterM ? 3 : 2)) {
        _state = AVOID; _avPhase = 0; _stateMs = now; _l = _r = 0; _lowN = 0;
        _avStillMs = 0; _avObA = 99; _avObL = 0; _avMid = false;
        strlcpy(_msg, "obstacle - waiting", sizeof(_msg));
        return;
      }
      const float v = _speed;                  // no slowing down: wheel differences stall it
      if (_lmkOn) { _lmkDrive(s, ry, v); return; }   // v3: landmark leg (own steering + own end)

      // ---- where to point
      float d = 0, wy = 0, rms = 1;
      uint8_t pts = 0;
      bool valid = _wallNow(s, wf, L.side, d, wy, rms, pts) && fabsf(_wrap(wy - L.ref)) < wallTolDeg;
      if (valid) valid = _wallFilter(d, wy);   // median of the last 5, single outliers (log_014: -2 -> -29 deg) dropped
      float yawDes = L.ref;
      const bool passing = _eff - _passEff < 2.5f;  // just passed an obstacle: parallel, no approach
      if (L.kind == WALL && valid && passing) {
        yawDes = wy;
      } else if (L.kind == WALL && valid) {
        // pure pursuit on the wall line: aim at the set distance lookAheadM ahead (+ = towards the wall)
        const float app = _clamp(atan2f(d - L.dSet, lookAheadM) * RAD_TO_DEG, -maxApproachDeg, maxApproachDeg);
        yawDes = wy + (L.side < 0 ? app : -app);
        if (rms < 0.04f && pts >= 8) _off = _wrap(_off + _clamp(anchorGain * _wrap(L.ref - wy), -0.5f, 0.5f));
      } else if (L.kind == HOLD && L.gpsAssist && !L.gpsBlind && gpsGood(s)) {
        float e, n;
        enu(s.lat(), s.lon(), L.lat, L.lon, e, n);
        if (e * e + n * n > 36.0f) {           // > 6 m from the end zone: head a bit towards it
          const float want = _wrap(kBearingOfRouteYaw0 - atan2f(e, n) * RAD_TO_DEG);
          yawDes = _wrap(L.ref + _clamp(_wrap(want - L.ref), -15.0f, 15.0f));
        }
      }
      // smooth the target: the wall angle from one 90-point scan jitters by a few degrees
      if (!_yawDesInit) { _yawDesF = yawDes; _yawDesInit = true; }
      _yawDesF = _wrap(_yawDesF + 0.5f * _wrap(yawDes - _yawDesF));
      if (_pathSteer()) {   // pure pursuit on the taught path; 06.11.: light low-pass (scan-match pose noise)
        const float pe = _pathErrRad() * RAD_TO_DEG;   // (clamped around the IMU ref on HOLD legs)
        if (!_peInit) { _peF = pe; _peInit = true; }
        _peF = _wrap(_peF + 0.6f * _wrap(pe - _peF));
        _drive(_peF, v, true);
      } else {
        _peInit = false;
        _drive(_wrap(_yawDesF - ry), v, true);                                         // fallback: wall / heading
      }                                         // fallback: wall / heading
      if (_avTries && _eff - _avEff > 3.0f) _avTries = 0;

      // ---- end of the leg?
      const bool gate = _eff >= L.gate * L.effort;
      bool end = false;
      switch (L.end) {
        case END_LOST:
          if (valid) { _seen = 1; _lostN = 0; } else if (_lostN < 255) _lostN++;
          end = gate && _seen && _lostN >= 6;
          break;
        case END_FOUND_L:
        case END_FOUND_R: {
          float fd, fwy, frms; uint8_t fp;
          const bool ok = _wallNow(s, wf, L.end == END_FOUND_L ? -1 : 1, fd, fwy, frms, fp) && fd < L.endArg;
          _foundN = ok ? (_foundN < 255 ? _foundN + 1 : 255) : 0;
          end = gate && _foundN >= 4;
          break;
        }
        case END_FRONT: {
          _fr[_frI++ & 3] = _corridor(s, 0, 0.35f, 3.0f);
          if (_frN < 4) _frN++;
          if (_frN >= 4) {  // median of the last 4 scans
            float a[4] = {_fr[0], _fr[1], _fr[2], _fr[3]};
            for (uint8_t x = 1; x < 4; x++) for (uint8_t y = x; y > 0 && a[y - 1] > a[y]; y--) { const float t = a[y]; a[y] = a[y - 1]; a[y - 1] = t; }
            end = gate && 0.5f * (a[1] + a[2]) < L.endArg;
          }
          break;
        }
        default:  // END_EFFORT
          end = _eff >= kEffortEnd * L.effort;
          if (!end && gate && !L.gpsBlind && gpsGood(s)) {  // GPS zone may end it a bit earlier
            float e, n;
            enu(s.lat(), s.lon(), L.lat, L.lon, e, n);
            end = e * e + n * n < 4.0f;
          }
          break;
      }
      // ---- LiDAR end match (RouteLocalizer): compare the scan with the taught end scan of the leg
      _loc.endStep(_scan, L.effort > 0 ? _eff / L.effort : 0, gate);
      // v3 (11.11., log_031): the LOCKED path localizer says the rover is clearly short of the taught path end ->
      // no leg end by effort / end scan / scan dip. log_031 leg 6 ended on effort 17.0 (avoid moves and slip count as
      // effort) while the localizer (score 0.6-0.9) said 10.5 of 17 m - leg 8 then turned 6 m early into the steps.
      if (_lpOn && pathLocked() && _lp.leg() == _i && _lp.s() < lpEndAgreeFrac * _lp.sEnd() - 0.5f) {
        if (!_vetoLogged && (_eff >= kEffortEnd * L.effort || _loc.dip())) {   // only when the old rule would have ended it
          _vetoLogged = true;
          Serial.printf("[route] leg %u: effort %.1f/%.1f but the localizer says %.1f of %.1f m - not the end yet\n",
                        (unsigned)(_i + 1), _eff, L.effort, _lp.s(), _lp.sEnd());
        }
        if (autoAdvance && _eff > 2.5f * L.effort + 3.0f) { _forced++; _nextLeg(s, "path: effort last resort"); }
        return;
      }
      if (_pathSteer()) {   // path mode: the leg ends at the end of the taught path (see the top of _step)
                            // (yaw-only legs fall through: taught distance + LiDAR end-scan match below)
        if (autoAdvance && _eff > 2.5f * L.effort + 3.0f) { _forced++; _nextLeg(s, "path: effort last resort"); }
        return;
      }
      if (endRule == RULE_COMBINED && _loc.hasMap()) {
        if (L.end == END_EFFORT) end = _eff >= kEffortEnd * L.effort;     // no GPS zone
        const bool byLandmark = end && _loc.looksLikeEnd();
        if (byLandmark || _loc.dip()) { _nextLeg(s, byLandmark ? "landmark + scan" : "scan dip"); return; }
        if (autoAdvance && _eff > lastResortFrac * L.effort + 2.0f) {   // last resort: end scan never matched
          _forced++;
          Serial.printf("[route] leg %u: end scan not matched after %.1f/%.1f effort -> next leg\n",
                        (unsigned)(_i + 1), _eff, L.effort);
          _nextLeg(s, "no end match, last resort");
          if (_state == TURN) {
            char m[48];
            snprintf(m, sizeof(m), "leg %u: %s (auto, no end match)", (unsigned)(_i + 1), _cur().name);
            strlcpy(_msg, m, sizeof(_msg));
          }
          return;
        }
        if (!autoAdvance && _eff > maxEffortFrac * L.effort + 4.0f) {
          _overrun = true;
          char why[48];
          snprintf(why, sizeof(why), "leg %u: end not found - check, Resume", (unsigned)(_i + 1));
          pause(why);
        }
        return;
      }
      // ---- RULE_OLD (before 2026-10-28)
      // GPS zone help for every leg (not only EFFORT legs): after the gate, inside 3 m of the
      // taught end point of the leg -> end it, even if the landmark was missed
      if (!end && gate && L.end != END_EFFORT && !L.gpsBlind && gpsGood(s)) {
        float e, n;
        enu(s.lat(), s.lon(), L.lat, L.lon, e, n);
        if (e * e + n * n < 9.0f) { end = true; _forced++; }
      }
      if (end) { _nextLeg(s, "landmark (old rule)"); return; }
      // wall leg whose wall is still there: the corner has not come yet - keep following it longer
      const float lim = (L.end == END_LOST && _lostN < 8 ? 2.5f : advanceEffortFrac) * L.effort + 2.0f;  // wall seen in the last 2 s
      if (autoAdvance && _eff > lim) {
        // landmark not found, but the leg is driven: switch to the next leg automatically
        _forced++;
        Serial.printf("[route] leg %u: no landmark after %.1f/%.1f effort -> next leg\n", (unsigned)(_i + 1), _eff, L.effort);
        _nextLeg(s, "no landmark (old rule)");
        if (_state == TURN) {
          char m[48];
          snprintf(m, sizeof(m), "leg %u: %s (auto, no landmark)", (unsigned)(_i + 1), _cur().name);
          strlcpy(_msg, m, sizeof(_msg));
        }
        return;
      }
      if (!autoAdvance && _eff > maxEffortFrac * L.effort + 4.0f) {
        _overrun = true;
        char why[48];
        snprintf(why, sizeof(why), "leg %u: end not found - check, Resume", (unsigned)(_i + 1));
        pause(why);
      }
      return;
    }
    default:
      _l = _r = 0;
      return;
  }
}

// ---- v3: landmark legs ---------------------------------------------------------------------------
bool RouteFollow::setLandmarkLeg(uint8_t legIdx, const LmkPhase* ph, uint8_t n, float lenM) {
  if (legIdx >= kN || !ph || !n) return false;
  for (uint8_t k = 0; k < _lmkN; k++) if (_lmkSlot[k].leg == legIdx) { _lmkSlot[k] = LmkSlot{legIdx, ph, n, lenM}; return true; }
  if (_lmkN >= sizeof(_lmkSlot) / sizeof(_lmkSlot[0])) return false;
  _lmkSlot[_lmkN++] = LmkSlot{legIdx, ph, n, lenM};
  return true;
}

void RouteFollow::_lmkBegin() {
  _lmkOn = false;
  _lmkWhy = "";
  for (uint8_t k = 0; k < _lmkN; k++) {
    const LmkSlot& sl = _lmkSlot[k];
    if (sl.leg == _i && sl.ph) { _lmk.sideParaExtraDeg = lmkParaExtraDeg; _lmk.begin(sl.ph, sl.n); _lmkOn = true; _lmkLen = sl.lenM; break; }
  }
  if (_lmkOn) Serial.printf("[route] leg %u is a LANDMARK leg (%u phases)\n", (unsigned)(_i + 1), (unsigned)_lmk.phases());
}

// DRIVE on a landmark leg: phases by distance, PID / heading anchor from landmark lines, own leg end.
// Obstacle handling, stuck detection and SafetyGuard ran before this (same as every leg).
bool RouteFollow::_lmkDrive(const Sensors& s, float ry, float v) {
  const Leg& L = _cur();
  // where on the leg: the locked localizer (scaled to the table's metres) beats effort (log_031: effort 40 % ahead)
  const bool lpOk = _lpOn && pathLocked() && _lp.leg() == _i && _lp.sEnd() > 0.5f;
  const float sM = (lpOk && _lmkLen > 0) ? _lp.s() * _lmkLen / _lp.sEnd() : legMetres();
  const bool tilted = fabsf(s.pitchDeg() - _pitch0) > lmkTiltDeg;
  // 12.11. (log_033, M51-M57): the pitch gate held EVERY phase on the ramp -> no left-wall steering, the rover went
  // for the right ramp wall / the steps. Now the pitch only holds lines ahead / behind; side walls are followed.
  const bool rolled = fabsf(s.rollDeg() - _roll0) > lmkRollDeg;
  LandmarkLeg::Out o = _lmk.step(_scan, ry, L.ref, sM, 0.25f, tilted, rolled);
  _lmkWhy = o.why;
  // the locked localizer at the end of the taught path ends a landmark leg too (like the path legs)
  if (!o.done && lpOk && _lp.atEnd() && _eff >= pathEndMinFrac * L.effort) { o.done = true; o.why = "path end"; }
  // heading anchor (removes gyro drift): at most 0.5 deg per scan, like the wall legs
  if (o.dOff != 0) _off = _wrap(_off + _clamp(o.dOff, -0.5f, 0.5f));
  if (o.done) {
    // a distance end only counts when the locked localizer agrees (same rule as the path legs); a STOP wall
    // ("end wall reached") is physically there and always ends the leg
    const bool distEnd = strcmp(o.why, "end wall reached") != 0 && strcmp(o.why, "entrance + stop distance") != 0;
    if (!(distEnd && lpOk && _lp.s() < lpEndAgreeFrac * _lp.sEnd() - 0.5f)) { _nextLeg(s, o.why); return true; }
    o.hold = true; o.why = "table end, localizer: not yet"; _lmkWhy = o.why;
  }
  // last resort: far beyond the taught distance and still no end -> next leg (no endless drive)
  if (_eff > 2.5f * L.effort + 3.0f) { _forced++; _nextLeg(s, "landmark leg: last resort"); return true; }
  // HOLD phase (no landmark planned): the taught path when the localizer is locked and matches well, else the course
  _lmkPath = o.hold && lpOk && _lp.score() >= minPathScore;
  if (_lmkPath) {
    const float pe = _pathErrRad() * RAD_TO_DEG;
    if (!_peInit) { _peF = pe; _peInit = true; }
    _peF = _wrap(_peF + 0.6f * _wrap(pe - _peF));
    _yawDesInit = false;
    _drive(_peF, v, true);
    return false;
  }
  _peInit = false;
  if (!_yawDesInit) { _yawDesF = o.yawDes; _yawDesInit = true; }
  _yawDesF = _wrap(_yawDesF + 0.5f * _wrap(o.yawDes - _yawDesF));   // same light smoothing as the wall legs
  _drive(_wrap(_yawDesF - ry), v, true);   // nose frame like ref: the taught lineOff already holds the crab
  return false;
}

// ---- v3 (11.11., log_030): turn tactics + start alignment in steps -------------------------------------------
// log_030 (box 7 / rover 7, start at M1, 77 deg off): the soft pivot 0.35 -> 0.50 and the swing turned the rover
// 8.6 deg in 50 s, the stuck check backed up 5 times -> PAUSE. Arjun's campus logs show the same: some paving
// LOCKS a pivot on the spot (full 0.50 -> 4-7 deg, then nothing), the same pivot turns 42 deg/s a metre further.
// So never insist on one way of turning (Arjun v12 RouteMission::_turn, Kethan's full-power pivot):
//   PIVOT  full turnCmd (0.50) at once (MotorShaper turn ramp 0.25 s), kept while >= 1 deg per 2 s
//   SWING  outer wheels full forward, inner wheels stand            (needs free way + floor ahead)
//   SHIFT  roll 0.3 m straight (wheels onto other stones); forward if free + floor ahead, else BACK if the
//          rear is free (LiDAR 150-210 deg > 0.55 m, back ultrasonic > 40 cm); net within +fwd / -back limits
//   ARC    outer wheels full forward, inner 0.15, max 6 s             (needs free way + floor ahead)
//   cycle PIVOT, SWING, SHIFT, PIVOT, ARC, SHIFT ... with 0.5 s REST (zero) between two tactics.
// "floor ahead" = the front-angled ultrasonic saw the ground (8-40 cm) within the last 1.5 s - it is the only
// drop sensor (raised start path!). And all forward rolling in one turn together <= fwdMoveMaxM (start turn:
// fwdMoveStartM), the arc at most 6 s (start: 2 s).
bool RouteFollow::_floorAhead(const Sensors& s) {
  // box 7 (log_030/031): flat ground reads 14-30 cm, but MOST readings are 300 (no echo) - "floor seen" blocked
  // every forward move in log_031. Now: 8-40 = floor, 300 / < 8 = unknown (allowed), 41-299 = an echo from further
  // down = the ground may fall away (edge of the raised path) -> forward blocked for 1 s.
  const uint32_t now = millis();
  const int a = s.usCm(4);
  if (a > 40 && a < Sensors::kUsMaxCm) _dropMs = now ? now : 1;
  return !(_dropMs != 0 && now - _dropMs < 1000);
}

bool RouteFollow::_rearFree(const Sensors& s) const {
  // a 0.3 m back shift needs ~0.55 m (log_031: the operator stood 0.7 m behind -> 0.8 m blocked every back shift)
  for (uint8_t i = 37; i <= 52; i++) { const uint16_t cm = s.lidarCm(i); if (cm > 25 && cm < 55) return false; }
  const int b = s.usCm(3);
  return !(b > 2 && b < 40);
}

// K-turn room: forward = corridor ahead (rover-wide) longer than 0.45 m, floor seen, within the forward limit;
// backward = rear free (LiDAR + back ultrasonic, _rearFree) and within the backward limit. margin = keep this much
// of the limit for the next piece.
bool RouteFollow::_kFwdRoom(const Sensors& s, float margin) const {
  return _corridor(s, 0, 0.22f, 1.0f) > 0.45f && _floorOk && _netM < (_startTurn ? fwdMoveStartM : fwdMoveMaxM) - margin;
}
bool RouteFollow::_kBackRoom(const Sensors& s, float margin) const {
  return _rearFree(s) && -_netM < backShiftMaxM - margin;
}

void RouteFollow::_tacStart(uint8_t t, const Sensors& s, uint32_t now, bool first) {
  if (first) { _tkNext = 1; _tkCycles = 0; }
  _tk = t; _tkMs = _tkWinMs = now; _tkYaw = s.yawNowDeg(); _shiftM = 0; _tkBoosted = false; _rollV = 0;
  // shifts alternate: back when the rover is already ahead of where the turn began (or forward is not allowed),
  // forward when it is behind -> it stays within +-fwdMoveStartM / backShiftMaxM of its start (log_031: two back
  // shifts used up the back allowance, after that only the locked pivot was left)
  if (t == TK_KTURN) {
    // next piece: the other direction than the last one if there is room, else the same, else none (wait)
    const bool fwdRoom = _kFwdRoom(s, 0.10f);
    const bool backRoom = _kBackRoom(s, 0.10f);
    int8_t want = _kDir == 0 ? (backRoom ? -1 : 1) : (int8_t)-_kDir;
    if ((want < 0 && !backRoom) || (want > 0 && !fwdRoom)) want = (int8_t)-want;
    if ((want < 0 && !backRoom) || (want > 0 && !fwdRoom)) want = 0;
    _kDir = want;
    _shiftBack = want < 0;
  }
  if (t == TK_SHIFT || t == TK_ROLL) {
    const bool fwdRoom = _corridor(s, 0, 0.25f, 1.5f) > 1.0f && _floorAhead(s) && _netM < (_startTurn ? fwdMoveStartM : fwdMoveMaxM) - 0.25f;
    const bool backRoom = _rearFree(s) && -_netM < backShiftMaxM - 0.25f;
    _shiftBack = (_netM > 0.05f && backRoom) || !fwdRoom;     // back if ahead (and possible), else forward if possible
  }
  static const char* kN[] = {"-", "pivot", "swing", "shift", "arc", "rest", "roll+pivot", "K-turn"};
  if (t != TK_REST) {
    snprintf(_tacMsg, sizeof(_tacMsg), "turn: %s%s", kN[t], (t == TK_SHIFT || t == TK_ROLL) ? (_shiftBack ? " back" : " fwd") :
             t == TK_KTURN ? (_kDir < 0 ? " backward curve" : (_kDir > 0 ? " forward curve" : " - no room, waiting")) : "");
    Serial.printf("[route] %s (%.0f deg to go)\n", _tacMsg, _ctrlErr);
  }
}

void RouteFollow::_tactic(const Sensors& s, float dt, uint32_t now) {
  // 12.11.: roll+pivot first (see ROLLING START), the older tactics after two tries
  static const uint8_t kSeqRoll[] = {TK_ROLL, TK_ROLL, TK_ARC, TK_ROLL, TK_SWING};
  static const uint8_t kSeq[] = {TK_PIVOT, TK_SWING, TK_SHIFT, TK_PIVOT, TK_ARC, TK_SHIFT};
  // start turn (log_031 at M1: a pivot gave ~5 deg right after each shift, then locked again; swing / arc gave ~1 deg
  // and used up the forward room): only pivot <-> shift, the shifts alternating forward / back around the start point
  static const uint8_t kSeqStart[] = {TK_PIVOT, TK_SHIFT};
  static const uint8_t kSeqStartRoll[] = {TK_ROLL};          // start (raised path): roll+pivot only, alternating back/fwd
  const uint8_t* seq = rollStart ? (_startTurn ? kSeqStartRoll : kSeqRoll) : (_startTurn ? kSeqStart : kSeq);
  const uint8_t nSeq = rollStart ? (_startTurn ? sizeof(kSeqStartRoll) : sizeof(kSeqRoll)) : (_startTurn ? sizeof(kSeqStart) : sizeof(kSeq));
  const float d = _tapDir;                                   // + = turn left
  const float yaw = s.yawNowDeg();
  const float moved = fabsf(_wrap(yaw - _tkYaw));
  _floorOk = _floorAhead(s);
  if (dt > 0 && dt < 0.1f) _netM += _outV * dt;                         // signed rolling in this turn (1 m/s per unit)
  const float fwdMax = _startTurn ? fwdMoveStartM : fwdMoveMaxM;
  const bool fwdOk = _corridor(s, 0, 0.25f, 1.5f) > 1.0f && _floorOk && _netM < fwdMax;
  _why = WHY_TAP;
  _l = _r = 0;
  bool stalled = false;
  auto window = [&](uint32_t firstMs, uint32_t nextMs, float minDeg) {
    const uint32_t w = (_tkWinMs == _tkMs) ? firstMs : nextMs;
    if (now - _tkWinMs < w) return false;
    if (moved >= minDeg) { _tkWinMs = now; _tkYaw = yaw; return false; }
    return true;
  };
  switch (_tk) {
    case TK_KTURN: {
      // one piece of the K-turn: both wheels the same direction, the outer one fast (see K-TURN in RouteFollow.h)
      if (dt > 0 && dt < 0.1f) _shiftM += fabsf(_outV) * dt;
      const bool back = _kDir < 0;
      if (_kDir == 0) {                                     // no room either way: stand, look again every 1 s
        if (now - _tkMs > 1000) _tacStart(TK_KTURN, s, now, false);
        return;
      }
      // a piece ends when the room in its direction is used up, or the rover is kSegM/2 past where the turn began
      // (forward and backward pieces then balance: it stays within +-0.2 m) - unless the other direction has no
      // room, then it goes on up to the forward / backward limits
      const bool ok = back ? _kBackRoom(s, 0.0f) : _kFwdRoom(s, 0.0f);
      const bool otherRoom = back ? _kFwdRoom(s, 0.10f) : _kBackRoom(s, 0.10f);
      const bool half = back ? (_netM <= -0.5f * kSegM) : (_netM >= 0.5f * kSegM);
      if (!ok || (half && otherRoom && _shiftM > 0.1f) || _shiftM >= 2.0f * kSegM || now - _tkMs > kSegMs) {
        _tacStart(TK_KTURN, s, now, false);
        return;
      }
      // turning left (d > 0): forward = right wheel fast; backward = LEFT wheel fast backward (r - l > 0 both times)
      const float o = kOuter, in = kInner;
      if (!back) { if (d > 0) { _l = in; _r = o; } else { _l = o; _r = in; } }
      else       { if (d > 0) { _l = -o; _r = -in; } else { _l = -in; _r = -o; } }
      return;
    }
    case TK_ROLL: {
      // ROLLING START: straight at rollCmd (back / forward chosen in _tacStart) until the wheels really move, then
      // straight into the pivot - no REST in between (that is the point: the turn starts while rolling)
      const bool ok = _shiftBack ? (_rearFree(s) && -_netM < backShiftMaxM) : fwdOk;
      if (dt > 0 && dt < 0.1f) _shiftM += fabsf(_outV) * dt;
      if (!ok || fabsf(_outV) >= rollGoV || _shiftM >= rollMaxM || now - _tkMs > 3000) {   // 13.11.: was 1.8 s (S-curve needs 2 s)
        const uint8_t keepNext = _tkNext;
        const float carry = ok ? (_shiftBack ? -rollCmd : rollCmd) : 0.0f;   // blocked: no rolling on into it
        _tacStart(TK_PIVOT, s, now, false);
        _tkNext = keepNext;
        _tkBoosted = true;                                 // 0.5 at once (rover 7)
        _rollV = carry;
        _l = carry - turnCmd * d; _r = carry + turnCmd * d;
        return;
      }
      const float v = _shiftBack ? -rollCmd : rollCmd;
      _l = _r = v;
      break;
    }
    case TK_PIVOT: {
      // 11.11.: Kethan's Turn-90 (cas_box_kethan_log): 0 -> 0.35 in 1 s (MotorShaper wUp 0.35/s), kept while it turns
      // >= 1 deg per 2 s; no response -> raised to turnCmd (0.50) for one more window, then the next tactic
      const float pc = _tkBoosted ? turnCmd : kethanCmd;
      // rolling start: the rolling speed stays in the command and fades out over rollCarryMs, so the wheels are
      // still moving when the turn command arrives (the MotorShaper ramps cannot make it a pivot from rest)
      float cv = 0;
      if (_rollV != 0 && now - _tkMs < rollCarryMs) {
        const bool okC = _rollV < 0 ? (_rearFree(s) && -_netM < backShiftMaxM) : fwdOk;
        cv = okC ? _rollV * (1.0f - (float)(now - _tkMs) / rollCarryMs) : 0.0f;
        if (!okC) _rollV = 0;
      }
      _l = cv - pc * d; _r = cv + pc * d;
      stalled = window(2000, 1500, 1.0f);
      if (stalled && !_tkBoosted) { _tkBoosted = true; _tkWinMs = now; _tkYaw = yaw; stalled = false; }
      // 12.11. late: Kethan's pivot is ALWAYS tried first (it turns on rover 4 / smooth floor); no turn response
      // (< 1 deg in its windows) -> K-turn for the rest of this turn
      if (stalled && kTurn) { _tacStart(TK_KTURN, s, now, false); return; }
      // 12.11.: stalled with the rolling start on -> roll again at once (no REST: the next turn starts from motion)
      if (stalled && rollStart && seq[_tkNext % nSeq] == TK_ROLL) {
        _tkNext = (_tkNext + 1) % nSeq;
        _tacStart(TK_ROLL, s, now, false);
        return;
      }
      break;
    }
    case TK_SWING:
      if (!fwdOk) { stalled = true; break; }
      if (d > 0) { _l = 0; _r = turnCmd; } else { _l = turnCmd; _r = 0; }
      stalled = window(2500, 1500, 3.0f);
      break;
    case TK_ARC:
      if (!fwdOk) { stalled = true; break; }
      if (d > 0) { _l = 0.15f; _r = turnCmd; } else { _l = turnCmd; _r = 0.15f; }
      stalled = window(3000, 2000, 3.0f) || now - _tkMs > (_startTurn ? 2000u : 6000u);
      break;
    case TK_SHIFT: {
      const bool ok = _shiftBack ? (_rearFree(s) && -_netM < backShiftMaxM) : fwdOk;
      if (!ok || _shiftM >= 0.30f || now - _tkMs > 4500) { stalled = true; break; }
      const float v = _shiftBack ? -0.20f : 0.25f;
      _l = _r = v;
      if (dt > 0 && dt < 0.1f) _shiftM += fabsf(_outV) * dt;
      break;
    }
    default:                                                 // REST: wheels to zero, then the next tactic
      if (now - _tkMs >= 500 && fabsf(_outV) < 0.02f && fabsf(_outW) < 0.02f) {
        if (_tkNext >= nSeq) { _tkNext = 0; _tkCycles++; }
      // forward rolling not allowed / used up: skip swing + arc (pivot and the back shift remain)
      if (!(_corridor(s, 0, 0.25f, 1.5f) > 1.0f && _floorAhead(s) && _netM < (_startTurn ? fwdMoveStartM : fwdMoveMaxM)))
        while (seq[_tkNext % nSeq] == TK_SWING || seq[_tkNext % nSeq] == TK_ARC) _tkNext = (_tkNext + 1) % nSeq;
        _tacStart(seq[_tkNext++], s, now, false);
      }
      return;
  }
  if (stalled) { _l = _r = 0; _tacStart(TK_REST, s, now, false); }
}

// START TURN (state TURN right after start() found the rover facing off the leg):
//   step   target = heading now + the error, at most +-90 deg per step (a "90 deg left / right" turn)
//   settle the step reached -> stand until |yaw rate| < 3 deg/s for 0.5 s (a clean LiDAR scan)
//   check  alignSearch again (+-0.8 m: the shifts moved it) -> new heading offset + localizer pose;
//          still more than turnDoneDeg off -> next step (max startMaxRounds), else DRIVE.
//          Check not sure -> keep the gyro (the first match was sure) and go on.
void RouteFollow::_startTurnStep(const Sensors& s, float ry, uint32_t now) {
  const Leg& L = _cur();
  if (isnan(_stepTgt)) {                                     // new step
    const float e = _wrap(L.ref - ry);
    _stepTgt = _wrap(ry + _clamp(e, -90.0f, 90.0f));
    _settleMs = 0;
    snprintf(_msg, sizeof(_msg), "start: turning %.0f deg (step %u)", _clamp(e, -90.0f, 90.0f), (unsigned)(_startRounds + 1));
  }
  const float e = _wrap(_stepTgt - ry);
  if (fabsf(e) >= startDoneDeg || _pivoting) {
    if (now - _stateMs > startTurnTimeoutMs) {
      pause("start: cannot turn - turn by hand, Resume");
      _startTurn = false;
      return;
    }
    _drive(e, _speed, false);                                // on the spot / tactics (forward only inside them)
    return;
  }
  // step reached: settle, then check with the LiDAR. (_rate is not updated while the wheels stand - _control does
  // not run - so the settle check uses the yaw change between two steps, 0.25 s)
  _l = _r = 0;
  const float yNow = s.yawDeg();
  const bool still = fabsf(_wrap(yNow - _settleYaw)) < 0.8f;
  _settleYaw = yNow;
  if (!still) { _settleMs = 0; return; }
  if (_settleMs == 0) { _settleMs = now; return; }
  if (now - _settleMs < 500) return;
  for (uint8_t k = 0; k < Sensors::kLidarPoints; k++) _scan[k] = s.lidarCm(k);
  float ax = 0, ay = 0, ath = 0, sc = 0, sec = 0;
  const bool ok = _lpOn && _lp.alignSearch(_scan, _i, 0.8f, ax, ay, ath, sc, sec);
  _startRounds++;
  if (ok) {
    _off = _wrap(L.ref + ath * RAD_TO_DEG - s.yawDeg());
    _lp.setPose(ax, ay, ath);
    _lpYawPrev = s.yawDeg();
  }
  const float rest = ok ? ath * RAD_TO_DEG : _wrap(routeYaw(s) - L.ref);
  Serial.printf("[route] start check %u: %s, %.0f deg off the leg, score %.2f (2nd %.2f)\n", (unsigned)_startRounds,
                ok ? "OK" : "not sure (gyro kept)", rest, sc, sec);
  _alignSc = sc; _alignSec = sec; _alignDeg = rest;
  // up to startDoneDeg off: drive - the rolling heading hold (curve, inner wheel >= 50 %) takes the rest; a 0.35 pivot
  // coasts ~10-14 deg and cannot make a small correction without overshooting (sim: endless re-checks)
  if (fabsf(rest) > startDoneDeg && _startRounds < startMaxRounds) { _stepTgt = NAN; _stateMs = now; return; }
  _startTurn = false;
  _state = DRIVE; _stateMs = now;
  snprintf(_msg, sizeof(_msg), "leg %u: %s", (unsigned)(_i + 1), L.name);
}

// ---- v4: smart obstacle handling (see RouteFollow.h, "SMART OBSTACLES") --------------------------------------

// New (not mapped) thing in the corridor ahead (2 x 0.35 m): distance (m) along the nose, 99 = none. Only on the
// LOCKED path - without the cm-exact leg map a wall at a corner would look like an obstacle at 1.5 m (the v3 rules
// at avoidEnterM / hardStopM stay in charge there).
float RouteFollow::_newAhead(const Sensors& s, float look, float* lat) {
  if (!pathLocked()) return 99.0f;
  for (uint8_t k = 0; k < Sensors::kLidarPoints; k++) _scan[k] = s.lidarCm(k);
  return _lp.newAhead(_scan, 0.35f, look, lat);
}

// The obstacle ahead: its edges from the scan (points at about its distance, neighbours < 0.3 m apart), the
// side with the smaller shift whose 45 deg diagonal and side ultrasonic are free. false = no way round.
bool RouteFollow::_avCluster(const Sensors& s, float& front, float& lo, float& hi) const {
  front = _corridor(s, 0, 0.35f, 3.0f);
  if (front >= 3.0f) return false;
  float lat[Sensors::kLidarPoints];
  uint8_t n = 0;
  for (uint8_t k = 0; k < Sensors::kLidarPoints; k++) {
    const uint16_t cm = s.lidarCm(k);
    if (cm < 25) continue;
    const float a = (k * 4.0f + 2.0f) * DEG_TO_RAD, rr = cm / 100.0f, al = rr * cosf(a), lt = rr * sinf(a);   // lt + = right
    if (al >= front - 0.15f && al <= front + 0.6f && fabsf(lt) < 2.0f) lat[n++] = lt;
  }
  if (!n) return false;
  for (uint8_t x = 1; x < n; x++) for (uint8_t q = x; q > 0 && lat[q - 1] > lat[q]; q--) { const float t = lat[q]; lat[q] = lat[q - 1]; lat[q - 1] = t; }
  int seed = -1;
  for (uint8_t k = 0; k < n; k++) if (fabsf(lat[k]) < 0.35f && (seed < 0 || fabsf(lat[k]) < fabsf(lat[seed]))) seed = k;
  if (seed < 0) return false;
  int a = seed, b = seed;
  while (a > 0 && lat[a] - lat[a - 1] < 0.3f) a--;
  while (b < n - 1 && lat[b + 1] - lat[b] < 0.3f) b++;
  lo = lat[a]; hi = lat[b];                                     // left edge (most negative), right edge
  return true;
}

bool RouteFollow::_avPlan(const Sensors& s, const Leg& L, float& shift, int8_t& dir, float& along) {
  float front, lo, hi;
  if (!_avCluster(s, front, lo, hi)) return false;
  if (hi - lo > avMaxWidthM) { strlcpy(_msg, "obstacle too wide - waiting", sizeof(_msg)); return false; }
  // a 4 deg LiDAR bin hides up to front * sin(4 deg) of the edge: add it
  const float binM = front * 0.07f;
  const float sL = fmaxf(-lo + avClearM + binM, 0.25f), sR = fmaxf(hi + avClearM + binM, 0.25f);
  const float sn = sinf(avAngleDeg * DEG_TO_RAD);
  auto ok = [&](float sh, int8_t d) {
    if (sh > avMaxShiftM || (d < 0 && L.noRight)) return false;
    const int u = s.usCm(d > 0 ? 1 : 2);                          // side ultrasonic: nothing right beside the rover
    if (u > 2 && u < 50) return false;
    const float need = sh / sn + 0.2f;                           // the diagonal up to the shift + half the rover
    return _corridor(s, -d * avAngleDeg, 0.25f, need) >= need - 0.01f;   // rover half width 0.13 + 0.12; + = right
  };
  const bool okL = ok(sL, 1), okR = ok(sR, -1);
  if (!okL && !okR) { strlcpy(_msg, "obstacle - no free side, waiting", sizeof(_msg)); return false; }
  dir = (okL && (!okR || sL <= sR)) ? 1 : -1;
  shift = dir > 0 ? sL : sR;
  along = front;
  Serial.printf("[route] obstacle %.2f m ahead, %.2f m wide (%.2f..%.2f) -> detour %s, shift %.2f m\n", front, hi - lo, lo, hi,
                dir > 0 ? "left" : "right", shift);
  return true;
}

// AVOID with smartAvoid: 0 stand + watch, 1 OUT (45 deg), 2 PASS (parallel), 3 BACK (45 deg back to the line)
void RouteFollow::_avoidSmart(const Sensors& s, const Leg& L, float ry, uint32_t now) {
  for (uint8_t i = 0; i < Sensors::kLidarPoints; i++) _scan[i] = s.lidarCm(i);
  if (_avPhase >= 1) {                                           // dead-reckoned offset from the line (m, + = left)
    const float de = (_odo - _avEffPrev) * lmkMPerEff, rel = _wrap(ry - _avBase) * DEG_TO_RAD;
    _avEffPrev = _odo;
    _avLat += de * sinf(rel);
    _avS += de * cosf(rel);
    if (now - _stateMs > 60000) { pause("detour took > 60 s - help me, Resume"); return; }
  }
  // never turn on the spot with something closer than 0.22 m to the centre (the body corners sweep ~0.2 m)
  if (_pivoting && _avPhase >= 1) {
    uint16_t mn = 999;
    for (uint8_t k = 0; k < Sensors::kLidarPoints; k++) { const uint16_t c = s.lidarCm(k); if (c >= 15 && c < mn) mn = c; }
    if (mn < 22) { pause("too close to turn - move me, Resume"); return; }
  }
  const float fr = _front(s);
  const bool fwdOk = _corridor(s, 0, 0.20f, 1.0f) > 0.45f;    // detour: the rover-wide corridor decides
  if (_avPhase >= 10) { _rerouteStep(s, L, ry, now); return; }   // v4b smooth reroute
  if (_avPhase == 0) {
    _l = _r = 0;
    // free again? nothing new within avoidPlanM on the locked path / corridor free otherwise
    float lat = 0;
    const float nd = pathLocked() ? _lp.newAhead(_scan, 0.35f, avoidPlanM + 0.5f, &lat) : _corridor(s, 0, 0.35f, avoidPlanM + 0.5f);
    const bool free = pathLocked() ? (nd >= avoidPlanM && _corridor(s, 0, 0.18f, 1.5f) > lpStopM + 0.05f) : fr > avoidFreeM - 0.2f;
    // re-planning in the middle of a detour: pass only once really beside it (the minimum lateral goal reached)
    if (free && _avMid && _avDir * (_avLat - _avGoalMin) >= 0) {
      if (_corridor(s, -_wrap(_avBase - ry), 0.20f, 1.0f) >= 0.60f) {   // the way parallel to the line is free
        _avMid = false; _avPhase = 2; _avEffPrev = _odo; strlcpy(_msg, "obstacle - passing", sizeof(_msg)); return;
      }
      const float g = _avLat + _avDir * 0.20f;                   // the corner is still in the way: 0.2 m further out
      if (fabsf(g) <= avMaxShiftM) {
        _avGoal = _avGoalMin = g; _avMid = false; _avPhase = 1; _avEffPrev = _odo;
        strlcpy(_msg, "obstacle - a bit further out", sizeof(_msg)); return;
      }
    }
    if (_avMid && _avTries >= 7) { pause("detour blocked - help me, then Resume"); return; }
    if (free && _avMid && _avPhase0Out()) {                       // not beside it yet: carry on OUT to the planned offset
      _avPhase = 1; _avEffPrev = _odo; _avMid = false; strlcpy(_msg, "obstacle - detour (going on)", sizeof(_msg)); return;
    }
    if (free) { _avMid = false; _state = DRIVE; strlcpy(_msg, "way free again", sizeof(_msg)); return; }
    // moving or standing? (judged only when the rover itself stands)
    // the obstacle = its cluster (front distance + centre of its edges): a flat face jitters point by point
    float cf = 99, clo = 0, chi = 0;
    const bool cl = _avCluster(s, cf, clo, chi);
    const float cc = cl ? 0.5f * (clo + chi) : 0.0f;
    if (fabsf(_outV) > 0.03f || !cl) { _avObA = cl ? cf : 99; _avObL = cc; _avStillMs = 0; return; }
    const bool moved = _avObA < 90 && (fabsf(cf - _avObA) > avMoveM || fabsf(cc - _avObL) > avMoveM);
    _avObA = cf; _avObL = cc;
    if (moved) { _avStillMs = 0; strlcpy(_msg, "obstacle moving - waiting", sizeof(_msg)); }
    else if (!_avStillMs) _avStillMs = now;
    const bool still = _avStillMs && now - _avStillMs >= staticMs;
    if (!still && now - _stateMs < 3000) return;                // people pass by: wait (max 3 s)
    float shift, along; int8_t dir;
    if (!_avPlan(s, L, shift, dir, along)) {
      if (now - _stateMs < 3000) return;
      // 12.11. (tools/sim_v3): too close to curve out of the way (rover 7 cannot turn on the spot) -> back up
      // straight ~0.5 m (BACKUP: 2.5 s at backupCmd) and plan again from there
      if (_avTries < 2 && _rearFree(s) && fr < 1.0f && !(L.end == END_FRONT && _eff >= 0.3f * L.effort)) {
        _avTries++; _state = BACKUP; _stateMs = now; _climbUntil = 0;
        strlcpy(_msg, "obstacle too close to go round - backing up", sizeof(_msg));
        Serial.println("[route] obstacle: no room to curve out -> back up and plan again");
        return;
      }
      if (++_avTries >= 3) { pause("blocked - help me, then Resume"); return; }
      _stateMs = now;                                            // wait another 3 s, then plan again
      return;
    }
    if (!_avMid) { _avBase = ry; _avLat = 0; _avS = 0; }       // a fresh detour (standing, facing it): the line is here
    _avMid = false;
    _avDir = dir; _avShift = shift;
    _avGoal = _clamp(_avLat + dir * shift, -avMaxShiftM, avMaxShiftM);   // lateral goal of OUT (m, + = left)
    _avGoalMin = _avLat + dir * fmaxf(shift - (avClearM - avMinClearM), 0.2f);   // enough if the diagonal runs out
    _avAlong = _avS + along;                                     // where the obstacle is, along the line
    _avEffPrev = _odo;
    _avPhase = 1; _avTries++; _stateMs = now;
    snprintf(_msg, sizeof(_msg), "obstacle - detour %s (%.0f cm)", dir > 0 ? "left" : "right", shift * 100.0f);
    return;
  }
  // something in the way of the detour (rover-wide corridor): already beside the obstacle with the minimum
  // clearance -> pass it now; else stand and re-plan, keeping the line and the offset
  // (the rover-wide corridor ahead along the PASS direction = the line: that is where it goes next)
  if (_corridor(s, 0, 0.20f, 1.0f) < 0.40f && !_pivoting && _avPhase == 1 && _avDir * (_avLat - _avGoalMin) >= 0 &&
      _corridor(s, -_wrap(_avBase - ry), 0.20f, 1.0f) >= 0.60f) {
    _avPhase = 2; strlcpy(_msg, "obstacle - passing (tight)", sizeof(_msg));
  }
  if (_corridor(s, 0, 0.20f, 1.0f) < 0.40f && !_pivoting && !(_avPhase == 2 && fabsf(_wrap(_avBase - ry)) > turnDoneDeg)) {
    _avPhase = 0; _avMid = true; _stateMs = now; _avStillMs = 0; _avObA = 99; _l = _r = 0; _avTries++;
    strlcpy(_msg, "detour blocked - re-planning", sizeof(_msg));
    return;
  }
  if (_avPhase == 1) {                                           // OUT: until beside the obstacle + clearance
    if (_avDir * (_avLat - _avGoal) >= 0) { _avPhase = 2; strlcpy(_msg, "obstacle - passing", sizeof(_msg)); }
    else if (_avS > _avAlong + 0.3f) { _avPhase = 0; _avMid = true; _stateMs = now; _avStillMs = 0; _avObA = 99; _l = _r = 0; return; }   // past it without the shift: re-check
    _drive(_wrap(_avBase + _avDir * avAngleDeg - ry), _speed, fwdOk);
    return;
  }
  if (_avPhase == 2) {                                           // PASS: parallel until it is behind
    const bool beside = _besideLine(s);                          // something between the rover and the line?
    if (_avS >= _avAlong + 0.6f && !beside) { _avPhase = 3; _avBackS = _avS; _avBackDir = 0; strlcpy(_msg, "obstacle passed - back to the line", sizeof(_msg)); }
    _drive(_wrap(_avBase - ry), _speed, true);
    return;
  }
  // BACK: 45 deg towards the line until the offset is gone (locked: the localiser's cross-track, else dead
  // reckoning), then the normal leg rules (pursuit / wall / heading)
  // the side to go back to is fixed when BACK starts (no flip-flopping when dead reckoning and the localiser disagree)
  if (_avBackDir == 0) _avBackDir = (pathLocked() ? _lp.crossTrack() : _avLat) > 0 ? -1 : 1;
  const int8_t back = _avBackDir;
  const bool onLine = (pathLocked() && fabsf(_lp.crossTrack()) < 0.15f) ||
                      (pathLocked() && back * _lp.crossTrack() > 0.0f) ||   // localiser: crossed the path
                      (!pathLocked() && -back * _avLat <= 0.10f);
  if (onLine || _avS - _avBackS > 2.0f * _avShift + 1.0f) {
    _peInit = false;
    _state = DRIVE; _passEff = _eff;
    strlcpy(_msg, "obstacle passed", sizeof(_msg));
    Serial.printf("[route] detour done (%.1f m along, %.2f m off)\n", _avS, _avLat);
    return;
  }
  _drive(_wrap(_avBase + back * avAngleDeg - ry), _speed, fwdOk);
}

// ---- v4b: smooth reroute (see RouteFollow.h, "SMOOTH REROUTE") -------------------------------------------------
#ifdef RR_DEBUG
#define RRDBG(w) Serial.printf("[rr] %s front %.2f\n", w, front)
#else
#define RRDBG(w)
#endif

// something beside the rover between it and the line (the obstacle not yet passed)?
bool RouteFollow::_besideLine(const Sensors& s) const {
  for (uint8_t k = 0; k < Sensors::kLidarPoints; k++) {
    const uint16_t cm = s.lidarCm(k);
    if (cm < 25) continue;
    const float a = (k * 4.0f + 2.0f) * DEG_TO_RAD, rr = cm / 100.0f, al = rr * cosf(a), lt = rr * sinf(a);
    const float toLine = _avLat > 0 ? lt : -lt;                  // the line is right of the rover when it is left of it
    if (al > -0.4f && al < 0.5f && toLine > 0.1f && toLine < fabsf(_avLat) + 0.3f) return true;
  }
  return false;
}

// Edges of the obstacle about front m ahead whose centre is near latHintCw (+ = right): points at its distance,
// neighbours < 0.3 m apart. lo = left edge, hi = right edge (cw lateral, m).
bool RouteFollow::_rrEdges(const Sensors& s, float front, float latHintCw, float& lo, float& hi) const {
  float lat[Sensors::kLidarPoints];
  uint8_t n = 0;
  for (uint8_t k = 0; k < Sensors::kLidarPoints; k++) {
    const uint16_t cm = s.lidarCm(k);
    if (cm < 25) continue;
    const float a = (k * 4.0f + 2.0f) * DEG_TO_RAD, rr = cm / 100.0f, al = rr * cosf(a), lt = rr * sinf(a);   // lt + = right
    if (al >= front - 0.15f && al <= front + 0.6f && fabsf(lt) < 2.5f) lat[n++] = lt;
  }
  if (!n) return false;
  for (uint8_t x = 1; x < n; x++) for (uint8_t q = x; q > 0 && lat[q - 1] > lat[q]; q--) { const float t = lat[q]; lat[q] = lat[q - 1]; lat[q - 1] = t; }
  int seed = -1;
  for (uint8_t k = 0; k < n; k++) if (fabsf(lat[k] - latHintCw) < 0.35f && (seed < 0 || fabsf(lat[k] - latHintCw) < fabsf(lat[seed] - latHintCw))) seed = k;
  if (seed < 0) return false;
  int a = seed, b = seed;
  while (a > 0 && lat[a] - lat[a - 1] < 0.3f) a--;
  while (b < n - 1 && lat[b + 1] - lat[b] < 0.3f) b++;
  lo = lat[a]; hi = lat[b];
  return true;
}

float RouteFollow::_curveY(const Curve& c, float sx) {
  if (sx <= c.s0) return c.y0;
  if (sx < c.s0 + c.l) { const float u = (sx - c.s0) / c.l; return c.y0 + (c.g - c.y0) * u * u * (3.0f - 2.0f * u); }
  if (c.sb < 0 || sx <= c.sb) return c.g;
  if (sx < c.sb + c.l2) { const float u = (sx - c.sb) / c.l2; return c.g * (1.0f - u * u * (3.0f - 2.0f * u)); }
  return 0.0f;
}

// Is the curve between sFrom and sTo free? Every LiDAR point (into the line frame: rover at _avS / _avLat, heading
// rel off the line) against the rover body (0.4 m long) swept along the curve: lateral distance >= clear.
bool RouteFollow::_rrFree(const Sensors& s, const Curve& c, float rel, float sFrom, float sTo, float clear) const {
  const float cr = cosf(rel), sr = sinf(rel);
  for (uint8_t k = 0; k < Sensors::kLidarPoints; k++) {
    const uint16_t cm = s.lidarCm(k);
    if (cm < 25) continue;
    const float a = (k * 4.0f + 2.0f) * DEG_TO_RAD, rr = cm / 100.0f, al = rr * cosf(a), ll = -rr * sinf(a);   // ll + = left
    const float px = _avS + al * cr - ll * sr, py = _avLat + al * sr + ll * cr;
    if (px < sFrom - 0.2f || px > sTo + 0.2f) continue;
    for (int j = -1; j <= 1; j++) {
      const float sc = px + 0.2f * j;
      if (sc < sFrom || sc > sTo) continue;
      if (fabsf(py - _curveY(c, sc)) < clear) return false;
    }
  }
  return true;
}

// Plan a smooth reroute around the new thing front m ahead (lateral latL, + = left). Starts a fresh line frame
// when no detour is running. true = AVOID phase 10.
bool RouteFollow::_rrTry(const Sensors& s, const Leg& L, float ry, float front, float latL, uint32_t now) {
  const bool fresh = _state != AVOID;
  const float base = fresh ? _lineYaw(L, ry) : _avBase, sNow = fresh ? 0.0f : _avS;
  const float yNow = fresh ? (pathLocked() ? _lp.crossTrack() : 0.0f) : _avLat;
  const float rel = _wrap(ry - base) * DEG_TO_RAD;
  float lo, hi;
  if (!_rrEdges(s, front, -latL, lo, hi)) { RRDBG("no seed"); return false; }
  if (hi - lo > rrMaxWidthM) { RRDBG("too wide"); return false; }   // wide things: stop + 45 deg detour (handles walls beside better)
  const float bin = fmaxf(front * 0.035f, 0.08f), v = fminf(_speed, rrSpeed), w = rrTurnDegS * DEG_TO_RAD;   // edge margin: half a 4 deg bin, >= 8 cm
  Curve best = {0, 0, 0, 1, -1, 1};
  float bestCost = 1e9f;
  for (int8_t d = 1; d >= -1; d -= 2) {
    if (d < 0 && L.noRight) continue;
    const float g = d > 0 ? yNow - lo + avClearM + bin : yNow - hi - avClearM - bin;   // lateral goal (+ = left)
    if (fabsf(g) > avMaxShiftM) { RRDBG("shift"); continue; }
    const int u = s.usCm(d > 0 ? 1 : 2);
    if (u > 2 && u < 50) { RRDBG("us"); continue; }
    const float lr = _clamp(sqrtf(6.0f * fabsf(g - yNow) * v / w), rrMinRampM, rrMaxRampM);
    if (front < 0.7f * lr + 0.5f) { RRDBG("room"); continue; }   // seen too late for a curve the rover can follow
    const Curve c = {sNow, yNow, g, lr, -1, lr};
    if (!_rrFree(s, c, rel, sNow, sNow + front + 1.0f, rrClearM)) { RRDBG("not free"); continue; }
    const float cost = fabsf(g - yNow);
    if (cost < bestCost) { bestCost = cost; best = c; }
  }
  if (bestCost > 1e8f) return false;
  if (fresh) { _avBase = base; _avS = 0; _avLat = yNow; _avTries = 0; }
  _avEffPrev = _odo;
  _rc = best;
  _avAlong = sNow + front;
  _avDir = best.g > yNow ? 1 : -1;
  _avShift = fabsf(best.g - yNow);
  _avGoal = best.g; _avGoalMin = best.g - _avDir * (avClearM - avMinClearM);   // if it hands over to the 45 deg rules
  _rrObY = yNow - 0.5f * (lo + hi);                              // obstacle centre, line frame (+ = left)
  _avMid = false;
  _state = AVOID; _avPhase = 10; _stateMs = now;
  snprintf(_msg, sizeof(_msg), "reroute %s (%.1f m ahead, %.0f cm)", _avDir > 0 ? "left" : "right", front, fabsf(best.g - yNow) * 100.0f);
  Serial.printf("[route] smooth reroute: obstacle %.2f m ahead, %.2f m wide -> %s to %.2f m, ramp %.1f m\n", front, hi - lo,
                _avDir > 0 ? "left" : "right", best.g, best.l);
  return true;
}

// 10 ramp out, 11 hold, 12 ramp back - pure pursuit on the planned curve, re-checked on every scan
void RouteFollow::_rerouteStep(const Sensors& s, const Leg& L, float ry, uint32_t now) {
  (void)L;
  const float rel = _wrap(ry - _avBase) * DEG_TO_RAD;
  const float v = fminf(_speed, rrSpeed), w = rrTurnDegS * DEG_TO_RAD;
  // closer = sharper picture (at 3 m a 40 cm box is 1-2 LiDAR points): re-measure the edges on every scan of the
  // ramp-out and move the curve further out if needed (only outwards; too far -> stop, the 45 deg rules decide)
  const float ahead = _avAlong - _avS;
  if ((_avPhase == 10 || _avPhase == 11) && ahead > 0.3f) {
    float lo, hi;
    if (_rrEdges(s, ahead, -(_rrObY - _avLat), lo, hi) && hi - lo <= avMaxWidthM) {
      const float bin = fmaxf(ahead * 0.035f, 0.08f);
      const float need = _avDir > 0 ? _avLat - lo + avClearM + bin : _avLat - hi - avClearM - bin;
      if (_avDir * (need - _rc.g) > 0.03f) {
        if (fabsf(need) > avMaxShiftM) {
          _avPhase = 0; _avMid = true; _stateMs = now; _avStillMs = 0; _avObA = 99; _l = _r = 0;
          strlcpy(_msg, "obstacle wider - stopping", sizeof(_msg));
          return;
        }
        const float lr = _clamp(sqrtf(6.0f * fabsf(need - _avLat) * v / w), rrMinRampM * 0.6f, rrMaxRampM);
        _rc = {_avS, _avLat, need, lr, -1, _rc.l2};
        _avGoal = need; _avGoalMin = need - _avDir * (avClearM - avMinClearM);
        _avPhase = 10;
        _rrObY = _avLat - 0.5f * (lo + hi);
      }
    }
  }
  if (_avPhase == 10 && _avS >= _rc.s0 + _rc.l) _avPhase = 11;
  if (_avPhase == 11 && _avS >= _avAlong + 0.6f && !_besideLine(s)) {   // passed: plan the way back
    Curve c = _rc;
    c.sb = _avS;
    c.l2 = _clamp(sqrtf(6.0f * fabsf(_rc.g) * v / w), rrMinRampM, rrMaxRampM);
    if (_rrFree(s, c, rel, _avS, c.sb + c.l2, rrClearM)) {
      _rc = c; _avPhase = 12;
      strlcpy(_msg, "obstacle passed - curving back", sizeof(_msg));
    } else if (_avS > _avAlong + 4.0f) {                         // no way back for 4 m: stop, the 45 deg rules decide
      _avPhase = 0; _avMid = true; _stateMs = now; _avStillMs = 0; _avObA = 99; _l = _r = 0;
      strlcpy(_msg, "no way back - stopping", sizeof(_msg));
      return;
    }
  }
  if (_avPhase == 12 && _avS >= _rc.sb + _rc.l2) {
    _state = DRIVE; _passEff = _eff; _peInit = false;
    strlcpy(_msg, "obstacle passed", sizeof(_msg));
    Serial.printf("[route] smooth reroute done (%.1f m along, %.2f m off)\n", _avS, _avLat);
    return;
  }
  // what lies ahead on the curve still free? (something new, or the obstacle bigger than it looked)
  const float sEnd = _avPhase == 12 ? _rc.sb + _rc.l2 : fmaxf(_avAlong + 0.8f, _rc.s0 + _rc.l);
  if (!_rrFree(s, _rc, rel, _avS, sEnd, rrClearM - 0.05f) || _corridor(s, 0, 0.18f, 1.0f) < 0.35f) {
    _avPhase = 0; _avMid = true; _stateMs = now; _avStillMs = 0; _avObA = 99; _l = _r = 0;   // firm stop, re-plan
    strlcpy(_msg, "reroute blocked - stopping", sizeof(_msg));
    Serial.println("[route] smooth reroute blocked -> stop, 45 deg detour rules");
    return;
  }
  // pure pursuit on the curve
  const float st = _avS + rrLd, yt = _curveY(_rc, st);
  const float want = _avBase + atan2f(yt - _avLat, rrLd) * RAD_TO_DEG;
  _drive(_wrap(want - ry), v, true);
}

// direction of the line a detour returns to: the taught path ahead when locked, else the leg heading
float RouteFollow::_lineYaw(const Leg& L, float ry) const {
  if (pathLocked()) return _wrap(ry + _lp.headingErrorToWaypoint(1.5f) * RAD_TO_DEG);
  return L.ref;
}

// a detour was under way (offset taken, obstacle not yet passed) -> continue it rather than drive back over it
bool RouteFollow::_avPhase0Out() const {
  return _avDir != 0 && fabsf(_avLat) > 0.15f && _avS < _avAlong + 0.3f;
}
